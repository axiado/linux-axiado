## Documentation/devicetree/bindings/pwm/axiado,ax3000-pwm.yaml
```yaml
# SPDX-License-Identifier: (GPL-2.0-only OR BSD-2-Clause)
%YAML 1.2
---
$id: http://devicetree.org/schemas/pwm/axiado,ax3000-pwm.yaml#
$schema: http://devicetree.org/meta-schemas/core.yaml#

title: Axiado AX3000 PWM

maintainers:
  - Akhila Kavi <akavi@axiado.com>
  - Makarand Pawagi <mpawagi@axiado.com>

description: |+
  Bindings for PWM on Axiado AX3000 SoC.

  - compatible:         Should be one of the following:
                        "axiado,ax3000-pwm"
  - reg:
      maxItems: 1

properties:
  compatible:
    enum:
      - axiado,ax3000-pwm

  "#pwm-cells":
    const: 2

  reg:
    maxItems: 1

  clocks:
    maxItems: 2
    description: phandle of the clock used by the PWM module

  interrupts:
    maxItems: 1
    description: IRQ for the Capture device

required:
  - compatible
  - reg
  - clocks
  - interrupts
  - '#pwm-cells'

additionalProperties: false

examples:
  - |
    pwm0: pwm@80500C00 {
    compatible = "axiado,ax3000-pwm";
    reg = <0x80801C00 0x1000>;
    #pwm-cells = <2>;
    clocks = <&refclk &refclk>;
    interrupt-parent = <&gic500>;
    interrupts = <0 93 4>;
    status = "disabled";
    };
...
```

## Documentation/devicetree/bindings/serial/axiado,espi-uart.yaml
```yaml
# SPDX-License-Identifier: (GPL-2.0-only OR BSD-2-Clause)
%YAML 1.2
---
$id: http://devicetree.org/schemas/serial/axiado,espi-uart.yaml#
$schema: http://devicetree.org/meta-schemas/core.yaml#

title: Axiado Universal Asynchronous Receiver/Transmitter (UART)

maintainers:
  - Sanket Parmar <sparmar@axiado.com>
  - Satya Jena <sjena@axiado.com>
  - Makarand Pawagi <mpawagi@axiado.com>
  - Prasad Bolisetty <pbolisetty@axiado.com>

description: |
  The Axiado UART is based on the basic 8250 UART. Parent ESPI controller
  handles the UART packets and provides interrupt management.

  This controller is a child device of the Axiado MFD SPI bridge and supports
  implementations where register access is performed via SPI to the TCU.

properties:
  compatible:
    const: axiado,ax3000-espi-uart

  reg:
    description: Slave address of the UART device
    maxItems: 1

  clocks:
    items:
      - description: The clock the baudrate is derived from
      - description: The bus clock for register accesses

  clock-names:
    items:
      - const: uart_clk
      - const: pclk

  interrupts:
    description: Virtual IRQ bit

  channel-index:
    $ref: /schemas/types.yaml#/definitions/uint32
    description: UART channel index. Supports up to 4 channel

  io-addr:
    $ref: /schemas/types.yaml#/definitions/uint32
    description: Base IO address used by ATU to route the packets

  fifo-size:
    $ref: /schemas/types.yaml#/definitions/uint32
    description: FIFO size of ESPI side UART instance

  cpu-fifo-size:
    $ref: /schemas/types.yaml#/definitions/uint32
    description: FIFO size of CPU side UART instance

required:
  - compatible
  - reg
  - clocks
  - clock-names
  - interrupts
  - interrupt-parent
  - channel-index
  - io-addr
  - fifo-size
  - cpu-fifo-size

unevaluatedProperties: false

examples:
  - |
    espi_uart0: espi-uart@40 {
        compatible = "axiado,ax3000-espi-uart";
        reg = <0x40 0x02>;
        interrupts = <5>;
        clock-names = "uart_clk", "pclk";
        clocks = <&refclk &refclk>;
        channel-index = <0>;
        io-addr = <0x3F8>;
        fifo-size = <16>;
        cpu-fifo-size = <64>;
        status = "disabled";
    };
```

## Documentation/devicetree/bindings/soc/axiado/axiado,ax3000-mctp.yaml
```yaml
# SPDX-License-Identifier: (GPL-2.0 OR BSD-2-Clause)
%YAML 1.2
---
$id: http://devicetree.org/schemas/soc/axiado/axiado,ax3000-mctp.yaml#
$schema: http://devicetree.org/meta-schemas/core.yaml#

title: Axiado MCTP driver

maintainers:
  - Shubhangini <shubhangini@axiado.com>
  - Sanket Parmar <sparmar@axiado.com>
  - Makarand Pawagi <mpawagi@axiado.com>
  - Prasad Bolisetty <pbolisetty@axiado.com>

description: |
  MCTP driver that deals with VDM messaging and adds hooks
  to the MCTP userspace lib.

properties:
  compatible:
    const: axiado,ax3000-mctp

  reg:
    description: OCM Base Address

  reg-names:
    const: ocm-base

  axrc-version:
    $ref: /schemas/types.yaml#/definitions/uint32
    description: For determining A0, B0, etc., encodes whether this is
      EP or RC as well. For EPs, bit 8 is set to 0x1.

  axrc-vdm-id:
    $ref: /schemas/types.yaml#/definitions/uint32
    description: For axrc-version == 1, this indicates which RC to bind
      for VDM generation. <2> -> X2, <1> -> X1

  isolated-cpu:
    $ref: /schemas/types.yaml#/definitions/uint32
    description: Isolated CPU number, Used to bind the OCM thread.

  pcie-phandle:
    $ref: /schemas/types.yaml#/definitions/phandle
    description: phandle of PCIe controller.

required:
  - compatible
  - reg
  - reg-names
  - axrc-version
  - axrc-vdm-id
  - isolated-cpu
  - pcie-phandle

additionalProperties: false

examples:
  - |
    mctp {
      compatible = "axiado,ax3000-mctp";
      reg = <0x0 0x802E0000 0x00 0x20000>;
      reg-names = "ocm-base";
      axrc-version = <0x001>;
      axrc-vdm-id = <2>;
      isolated-cpu = <3>;
      pcie-phandle = <&pcie_x2>;
    };
```

## Documentation/devicetree/bindings/soc/axiado/axiado,ax3000-sysutils.yaml
```yaml
# SPDX-License-Identifier: (GPL-2.0 OR BSD-2-Clause)
%YAML 1.2
---

$id: http://devicetree.org/schemas/soc/axiado/axiado,ax3000-sysutils.yaml#
$schema: http://devicetree.org/meta-schemas/core.yaml#

title: Axiado AX3000 Sysutils (Logger, Firmware Upgrade, Board ID)

maintainers:
  - Sammai Chakravarthy <schakravarthy@axiado.com>
  - Sridhar Pothuganti <spothuganti@axiado.com>
  - Prasad Bolisetty <pbolisetty@axiado.com>

description: |
  Unified sysutils driver for the Axiado AX3000 SoC.

select:
  properties:
    compatible:
      enum:
        - axiado,ax-logger
        - axiado,ax-fwupgrade
        - axiado,board-id

properties:
  compatible:
    enum:
      - axiado,ax-logger
      - axiado,ax-fwupgrade
      - axiado,board-id

  reg:
    description: Base address and size of memory-mapped region.
    maxItems: 1

  node-name:
    description: Optional logger node name.
    $ref: /schemas/types.yaml#/definitions/string

required:
  - compatible
  - reg

additionalProperties: false

examples:
  - |
    ax_logger_sysmgr: ax-log@800000 {
        compatible = "axiado,ax-logger";
        reg = <0x0 0x800000 0x0 0xfa00>;
        node-name = "log-sysmgr";
    };

  - |
    ax_board_info: board-info@80620808 {
        compatible = "axiado,board-id";
        reg = <0x0 0x80620808 0x0 0x4>;
    };

  - |
    update: fw-update@4a00000 {
        compatible = "axiado,ax-fwupgrade";
        reg = <0x0 0x04a00000 0x0 0x08000000>;
    };
```

## arch/arm64/configs/ax3000_defconfig
```kconfig
CONFIG_SYSVIPC=y
CONFIG_SYSVIPC_SYSCTL=y
CONFIG_PREEMPT=y
CONFIG_BSD_PROCESS_ACCT=y
CONFIG_BSD_PROCESS_ACCT_V3=y
CONFIG_IKCONFIG=y
CONFIG_IKCONFIG_PROC=y
CONFIG_LOG_BUF_SHIFT=17
CONFIG_LOG_CPU_MAX_BUF_SHIFT=12
CONFIG_PRINTK_SAFE_LOG_BUF_SHIFT=13
CONFIG_CGROUPS=y
CONFIG_PAGE_COUNTER=y
CONFIG_MEMCG=y
CONFIG_MEMCG_KMEM=y
CONFIG_CGROUP_SCHED=y
CONFIG_FAIR_GROUP_SCHED=y
CONFIG_CGROUP_PIDS=y
CONFIG_CGROUP_RDMA=y
CONFIG_CGROUP_FREEZER=y
CONFIG_CPUSETS=y
CONFIG_PROC_PID_CPUSET=y
CONFIG_CGROUP_DEVICE=y
CONFIG_CGROUP_CPUACCT=y
CONFIG_CGROUP_PERF=y
CONFIG_CGROUP_BPF=y
CONFIG_CGROUP_MISC=y
CONFIG_CGROUP_DEBUG=y
CONFIG_NAMESPACES=y
CONFIG_UTS_NS=y
CONFIG_TIME_NS=y
CONFIG_IPC_NS=y
CONFIG_USER_NS=y
CONFIG_PID_NS=y
CONFIG_BLK_DEV_INITRD=y
CONFIG_SMC_LEGOC2_CPLD=y
CONFIG_EXPERT=y
CONFIG_FHANDLE=y
CONFIG_EPOLL=y
CONFIG_SIGNALFD=y
CONFIG_TIMERFD=y
CONFIG_EVENTFD=y
CONFIG_NET=y
CONFIG_PACKET=y
CONFIG_PACKET_DIAG=y
CONFIG_UNIX=y
CONFIG_UNIX_DIAG=y
CONFIG_UNIX98_PTYS=y
CONFIG_INET=y
CONFIG_IPV6=y
CONFIG_TLS=y
CONFIG_TLS_DEVICE=y
CONFIG_NET_TLS=y
CONFIG_MACVLAN=y
CONFIG_MACVTAP=y
CONFIG_VETH=y
CONFIG_ETHERNET=y
CONFIG_NET_VENDOR_AXIADO=y
CONFIG_NETDEVICES=y
CONFIG_PHYLIB=y
CONFIG_MARVELL_PHY=y
CONFIG_MARVELL_10G_PHY=y
CONFIG_MDIO_DEVICE=y
CONFIG_MDIO_BUS=y
CONFIG_OF_MDIO=y
CONFIG_PHY_XGENE=y
CONFIG_PHY_MIXEL_MIPI_DPHY=y
CONFIG_NET_NS=y
CONFIG_NETFILTER=y
CONFIG_NETFILTER_NETLINK=y
CONFIG_NETFILTER_XTABLES=y
CONFIG_BRIDGE_NETFILTER=y
CONFIG_NETFILTER_XT_MARK=y
CONFIG_NETFILTER_XT_MATCH=y
CONFIG_NETFILTER_XT_MATCH_ADDRTYPE=y
CONFIG_NETFILTER_XT_MATCH_CONNTRACK=y
CONFIG_NETFILTER_XT_MATCH_IPVS=y
CONFIG_NETFILTER_XT_MATCH_POLICY=y
CONFIG_NETFILTER_XT_TARGET_CHECKSUM=y
CONFIG_NETFILTER_XT_TARGET_LOG=y
CONFIG_NETFILTER_XT_TARGET_MARK=y
CONFIG_IP_ADVANCED_ROUTER=y
CONFIG_IP_MULTIPLE_TABLES=y
CONFIG_IP_MULTICAST=y
CONFIG_IP_ROUTER=y
CONFIG_IP_MROUTE=y
CONFIG_IP_ROUTE_FWMARK=y
CONFIG_NET_IPIP=y
CONFIG_IP_NF_IPTABLES=y
CONFIG_IP_NF_FILTER=y
CONFIG_IP_NF_NAT=y
CONFIG_IP_NF_MANGLE=y
CONFIG_IP_NF_RAW=y
CONFIG_IP_NF_SECURITY=y
CONFIG_IP_NF_ARPTABLES=y
CONFIG_IP_NF_ARPFILTER=y
CONFIG_IP_NF_ARP_MANGLE=y
CONFIG_IP_NF_CONNTRACK=y
CONFIG_IP_NF_FTP=y
CONFIG_IP_NF_MATCH_AH=y
CONFIG_IP_NF_MATCH_ECN=y
CONFIG_IP_NF_MATCH_LIMIT=y
CONFIG_IP_NF_MATCH_MAC=y
CONFIG_IP_NF_MATCH_MARK=y
CONFIG_IP_NF_MATCH_MULTIPORT=y
CONFIG_IP_NF_MATCH_OWNER=y
CONFIG_IP_NF_MATCH_RPFILTER=y
CONFIG_IP_NF_MATCH_STATE=y
CONFIG_IP_NF_MATCH_TCPMSS=y
CONFIG_IP_NF_MATCH_TOS=y
CONFIG_IP_NF_MATCH_TTL=y
CONFIG_IP_NF_MATCH_UNCLEAN=y
CONFIG_IP_NF_TARGET_CLUSTERIP=y
CONFIG_IP_NF_TARGET_ECN=y
CONFIG_IP_NF_TARGET_LOG=y
CONFIG_IP_NF_TARGET_MASQUERADE=y
CONFIG_IP_NF_TARGET_MIRROR=y
CONFIG_IP_NF_TARGET_NETMAP=y
CONFIG_IP_NF_TARGET_REDIRECT=y
CONFIG_IP_NF_TARGET_REJECT=y
CONFIG_IP_NF_TARGET_SYNPROXY=y
CONFIG_IP_NF_TARGET_TCPMSS=y
CONFIG_IP_NF_TARGET_TTL=y
CONFIG_IP_NF_COMPAT_IPCHAINS=y
CONFIG_IP_NF_COMPAT_IPFWADM=y
CONFIG_NF_CONNTRACK_MARK=y
CONFIG_NF_DEFRAG_IPV4=y
CONFIG_NF_SOCKET_IPV4=y
CONFIG_NF_TPROXY_IPV4=y
CONFIG_NF_DUP_IPV4=y
CONFIG_NF_LOG_ARP=y
CONFIG_NF_LOG_IPV4=y
CONFIG_NF_REJECT_IPV4=y
CONFIG_NF_NAT_H323=y
CONFIG_NF_NAT_PPTP=y
CONFIG_NF_NAT_SNMP_BASIC=y
CONFIG_NF_TABLES_IPV4=y
CONFIG_NF_TABLES_ARP=y
CONFIG_NFT_REJECT_IPV4=y
CONFIG_NFT_DUP_IPV4=y
CONFIG_NFT_FIB_IPV4=y
CONFIG_NF_FLOW_TABLE_IPV4=y
CONFIG_IP6_NF_IPTABLES=y
CONFIG_IPV6_MULTIPLE_TABLES=y
CONFIG_INET6_AH=y
CONFIG_INET6_ESP=y
CONFIG_INET6_IPCOMP=y
CONFIG_INET6_XFRM_MODE_TRANSPORT=y
CONFIG_INET6_XFRM_MODE_TUNNEL=y
CONFIG_INET6_XFRM_MODE_BEET=y
CONFIG_XFRM=y
CONFIG_XFRM_OFFLOAD=y
CONFIG_XFRM_INTERFACE=y
CONFIG_XFRM_USER=y
CONFIG_NET_KEY=y
CONFIG_XFRM_AXIADO=y
CONFIG_XFRM_AXIADO_MOD=y
CONFIG_INET_AH=y
CONFIG_INET_ESP=y
CONFIG_INET_ESP_OFFLOAD=y
CONFIG_INET_IPCOMP=y
CONFIG_INET_XFRM_MODE_TRANSPORT=y
CONFIG_INET_XFRM_MODE_TUNNEL=y
CONFIG_INET_XFRM_MODE_BEET=y
CONFIG_VLAN_8021Q=y
CONFIG_PHYS_ADDR_T_64BIT=y
CONFIG_KALLSYMS_ALL=y
CONFIG_KEXEC=y
CONFIG_KEXEC_FILE=y
CONFIG_CRASH_DUMP=y
CONFIG_ARCH_AXIADO=y
CONFIG_SOC_AXIADO=y
CONFIG_ARM64_VA_BITS_48=y
CONFIG_NR_CPUS=4
# CONFIG_RODATA_FULL_DEFAULT_ENABLED is not set
# CONFIG_ARM64_TAGGED_ADDR_ABI is not set
CONFIG_COMPAT=y
# CONFIG_ARM64_RAS_EXTN is not set
# CONFIG_ARM64_CNP is not set
# CONFIG_ARM64_PTR_AUTH is not set
# CONFIG_ARM64_AMU_EXTN is not set
# CONFIG_ARM64_BTI is not set
# CONFIG_ARM64_E0PD is not set
# CONFIG_ARM64_EPAN is not set
# CONFIG_ARM64_SVE is not set
# CONFIG_EFI is not set
CONFIG_JUMP_LABEL=y
# CONFIG_SECCOMP is not set
# CONFIG_COMPAT_32BIT_TIME is not set
CONFIG_MODULES=y
CONFIG_MODULE_UNLOAD=y
# CONFIG_BLK_DEBUG_FS is not set
# CONFIG_CORE_DUMP_DEFAULT_ELF_HEADERS is not set
# CONFIG_COMPAT_BRK is not set
CONFIG_PAGE_REPORTING=y
CONFIG_MEMORY_FAILURE=y
CONFIG_TRANSPARENT_HUGEPAGE=y
CONFIG_PCI=y
CONFIG_PCIE_AXIADO=y
CONFIG_DEVTMPFS=y
CONFIG_DEVTMPFS_MOUNT=y
CONFIG_FW_LOADER_USER_HELPER=y
CONFIG_FW_LOADER_USER_HELPER_FALLBACK=y
# CONFIG_ARM_SMCCC_SOC_ID is not set
# CONFIG_BLK_DEV is not set
CONFIG_INPUT_FF_MEMLESS=y
CONFIG_INPUT_MATRIXKMAP=y
CONFIG_INPUT_EVDEV=y
# CONFIG_SERIO_SERPORT is not set
CONFIG_SERIO_AMBAKMI=y
CONFIG_USERIO=y
CONFIG_VT_HW_CONSOLE_BINDING=y
CONFIG_LEGACY_PTY_COUNT=16
CONFIG_SERIAL_8250_AXIADO=y
CONFIG_SERIAL_XILINX_PS_UART=y
CONFIG_SERIAL_XILINX_PS_UART_CONSOLE=y
CONFIG_SERIAL_DEV_BUS=y
CONFIG_IPMI_HANDLER=y
CONFIG_I2C=y
CONFIG_I2C_CHARDEV=y
CONFIG_I2C_MUX=y
CONFIG_I2C_MUX_PCA9541=y
CONFIG_I2C_MUX_PCA954x=y
CONFIG_I2C_CADENCE=y
CONFIG_I2C_CADENCE_REGMAP=y
CONFIG_I2C_SLAVE=y
CONFIG_I2C_AXIADO_XIIC_SLAVE=y
CONFIG_I2C_CROS_EC_TUNNEL=y
CONFIG_I3C=y
CONFIG_I3C_RENESAS_HUB=y
CONFIG_CDNS_I3C_MASTER=y
# CONFIG_HW_RANDOM is not set
CONFIG_GPIOLIB=y
CONFIG_OF_GPIO=y
CONFIG_GPIOLIB_IRQCHIP=y
CONFIG_SPI=y
CONFIG_SPI_MEM=y
CONFIG_SPI_AXIADO=y
CONFIG_GPIO_SYSFS=y
CONFIG_GPIO_CDEV=y
CONFIG_GPIO_CDEV_V1=y
CONFIG_GPIO_GENERIC=y
CONFIG_GPIO_CADENCE=y
CONFIG_GPIO_PCA953X=y
CONFIG_GPIO_PCA953X_IRQ=y
CONFIG_AXIADO_SGPIO=y
CONFIG_AXIADO_SGPIO_REGMAP=y
CONFIG_AXIADO_LTPI=y
CONFIG_AXIADO_LTPI_REGMAP=y
CONFIG_AXIADO_ESPI=y
CONFIG_AXIADO_KCS_IPMI_BMC=y
CONFIG_AXIADO_ESPI_SNOOP=y
CONFIG_AXIADO_SYSUTILS=y
CONFIG_POWER_RESET_XGENE=y
CONFIG_POWER_RESET_SYSCON=y
CONFIG_SYSCON_REBOOT_MODE=y
CONFIG_HWMON=y
CONFIG_SENSORS_IIO_HWMON=y
CONFIG_SENSORS_AXIADO_PWM_FAN=y
CONFIG_DRM=y
CONFIG_DRM_CROS_EC_ANX7688=y
CONFIG_DRM_AXIADO=y
CONFIG_AXIADO_HDMI=y
CONFIG_AXIADO_LCDC=y
CONFIG_MFD_CORE=y
CONFIG_MFD_AXIADO_SPI=y
CONFIG_MFD_AXIADO_SPI_DEBUG_FS=y
# CONFIG_MEDIA_CEC_SUPPORT is not set
CONFIG_MEDIA_SUPPORT=y
CONFIG_VIDEO_AXIADO=y
CONFIG_HID_AXIADO=y
CONFIG_USB=y
CONFIG_USB_XHCI_HCD=y
CONFIG_USB_XHCI_DBGCAP=y
CONFIG_USB_XHCI_PLATFORM=y
CONFIG_USB_GADGET=y
CONFIG_USB_CRG_UDC=y
CONFIG_USB_CONFIGFS=y
CONFIG_USB_CONFIGFS_MASS_STORAGE=y
CONFIG_USB_CONFIGFS_F_HID_AXIADO=y
CONFIG_AXIADO_USB_A0=y
CONFIG_MMC=y
CONFIG_MMC_SDHCI=y
CONFIG_MMC_SDHCI_PLTFM=y
CONFIG_MMC_SDHCI_OF_ARASAN=y
CONFIG_RTC_CLASS=y
# CONFIG_RTC_NVMEM is not set
CONFIG_RTC_DRV_CADENCE=y
# CONFIG_VIRTIO_MENU is not set
# CONFIG_VHOST_MENU is not set
CONFIG_CHROME_PLATFORMS=y
CONFIG_CROS_EC=y
# CONFIG_SURFACE_PLATFORMS is not set
CONFIG_HWSPINLOCK=y
# CONFIG_IOMMU_SUPPORT is not set
CONFIG_REMOTEPROC=y
CONFIG_AXIADO_MCTP=y
CONFIG_RESET_CONTROLLER=y
CONFIG_PHY_AX3000_EMMC=y
CONFIG_EXT4_FS=y
# CONFIG_DNOTIFY is not set
CONFIG_INOTIFY_USER=y
CONFIG_MSDOS_FS=y
CONFIG_VFAT_FS=y
CONFIG_PROC_FS=y
CONFIG_PROC_KCORE=y
CONFIG_SYSFS=y
CONFIG_TMPFS=y
CONFIG_HUGETLBFS=y
CONFIG_NLS_CODEPAGE_437=y
CONFIG_NLS_ISO8859_1=y
CONFIG_KEYS=y
CONFIG_SECURITY=y
CONFIG_LSM="landlock,lockdown,yama,loadpin,safesetid,integrity,bpf"
# CONFIG_CRYPTO_MANAGER_DISABLE_TESTS is not set
CONFIG_CRYPTO_CBC=y
CONFIG_CRYPTO_ECB=y
CONFIG_CRYPTO_CCM=y
CONFIG_CRYPTO_GCM=y
CONFIG_CRYPTO_SEQIV=y
CONFIG_CRYPTO_ECHAINIV=y
CONFIG_CRYPTO_CMAC=y
CONFIG_CRYPTO_MD5=y
CONFIG_CRYPTO_SHA1=y
CONFIG_CRYPTO_DEFLATE=y
# CONFIG_CRYPTO_HW is not set
CONFIG_DYNAMIC_DEBUG=y
# CONFIG_DEBUG_MISC is not set
CONFIG_DEBUG_INFO_DWARF_TOOLCHAIN_DEFAULT=y
CONFIG_MAGIC_SYSRQ=y
CONFIG_DEBUG_FS=y
# CONFIG_SCHED_DEBUG is not set
# CONFIG_FTRACE is not set
# CONFIG_STRICT_DEVMEM is not set
# CONFIG_RUNTIME_TESTING_MENU is not set
CONFIG_MEMTEST=y
CONFIG_IIO=y
CONFIG_IIO_BUFFER=y
CONFIG_IIO_TRIGGERED_BUFFER=y
CONFIG_AXIADO_SARADC=y
CONFIG_PWM=y
CONFIG_PWM_AXIADO=y
CONFIG_MISC_AXIADO=y
CONFIG_AXIADO_IPC=y

# MCTP Device Drivers
#
CONFIG_MCTP=y
CONFIG_MCTP_FLOWS=y
CONFIG_MCTP_SERIAL=y
CONFIG_MCTP_TRANSPORT_I2C=y
CONFIG_MCTP_TRANSPORT_I3C=y
CONFIG_I3C_MCTP=y
# CONFIG_I3C_MCTP_HDR_DDR is not set
CONFIG_I3C_TARGET_MCTP=y
CONFIG_MCTP_TRANSPORT_USB=y
# end of MCTP Device Drivers
```

## drivers/media/platform/axiado/Kconfig
```kconfig
# SPDX-License-Identifier: GPL-2.0-only
comment "Axiado media platform drivers"
config VIDEO_AXIADO
	bool "Axiado video driver"
	depends on VIDEO_DEV
	help
		Video4Linux2 driver for the Axiado KVM requirement.
		Support for V4L2 dev node(/dev/videoX) creation and
		handling data from these nodes. V4L2 is a collection of
		device driver and API for supporting real time video
		capture on Linux systems.
```
