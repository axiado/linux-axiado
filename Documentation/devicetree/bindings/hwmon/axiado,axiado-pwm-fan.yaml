## Documentation/devicetree/bindings/ltpi/axiado,ltpi-gpio.yaml
```yaml
# SPDX-License-Identifier: (GPL-2.0-only OR BSD-2-Clause)
%YAML 1.2
---
$id: http://devicetree.org/schemas/ltpi/axiado,ltpi-gpio.yaml#
$schema: http://devicetree.org/meta-schemas/core.yaml#

title: Axiado LTPI GPIO Driver

maintainers:
  - Tzu-Hao Wei <twei@axiado.com>
  - Swark Yang <syang@axiado.com>
  - Prasad Bolisetty <pbolisetty@axiado.com>

description: |
  The Axiado LTPI (Low-Speed Transport Protocol Interface) GPIO driver provides
  a GPIO controller that offers bidirectional GPIO functionality with interrupt support.
  It supports both input and output GPIO lines with configurable initial output values.

  The LTPI GPIO driver can operate in two modes:
  1. Direct memory mapping mode - when reg property provides memory region
  2. Regmap mode - when parent device provides regmap interface

properties:
  compatible:
    const: axiado,ltpi

  reg:
    description: |
      Memory region for LTPI registers. Contains base address and size.
      When used with regmap mode, the base address represents the offset
      within the parent device's regmap.
    maxItems: 1

  gpio-controller: true

  '#gpio-cells':
    description: |
      Must be 2. The first cell is the GPIO number and the second cell
      is used to specify flags. The first half of GPIOs (0 to ngpios-1)
      are output-only, the second half (ngpios to 2*ngpios-1) are input-only.
    const: 2

  interrupt-controller: true

  '#interrupt-cells':
    description: |
      Must be 2. The first cell is the interrupt number and the second
      cell is used to specify flags.
    const: 2

  interrupts:
    description: |
      Interrupt specifier for the LTPI GPIO driver. This interrupt is
      triggered when input GPIO state changes.
    maxItems: 1

  ngpios:
    description: |
      Number of GPIO lines supported by this controller. Must be a multiple
      of 32 and not exceed 128.
    minimum: 32
    maximum: 128
    multipleOf: 32

  dout-init:
    description: |
      Array of 32-bit values specifying the initial output state for
      each GPIO bank. The number of elements should match the number
      of banks required for the specified ngpios (ceil(ngpios/32)).
      Each bit in a 32-bit value corresponds to one GPIO line.
    $ref: /schemas/types.yaml#/definitions/uint32-array
    minItems: 1
    maxItems: 4

  ltpi-support-gpio:
    description: |
      Enabling gpio support in SCM local capabilities.
      Configuring the local capability register based on the
      HPM remote capabilities.

  ltpi-support-i2c:
    description: |
      Enabling i2c support in SCM local capabilities.
      Configuring the local capability register based on the
      HPM remote capabilities.

  ltpi-support-uart:
    description: |
      Enabling uart support in SCM local capabilities.
      Configuring the local capability register based on the
      HPM remote capabilities.

  ltpi-support-data:
    description: |
      Enabling data support in SCM local capabilities.
      Configuring the local capability register based on the
      HPM remote capabilities.

  ltpi-support-oem:
    description: |
      Enabling oem support in SCM local capabilities.
      Configuring the local capability register based on the
      HPM remote capabilities. Currently SCM don't have support for OEM.

  ltpi-support-nl-gpio-count:
    description: |
      SCM supports maximum of 128 bit of nl-gpios.
      Configuring nl-gpio count in local SMC capabilities based on the
      gpio support enable and the HPM remote capabilities.

  ltpi-support-i2c-channels:
    description: |
      SCM supports maximum of 6 I2C channels.
      Configuring I2C channel in local capabilities based on the
      I2C support enable and the HPM remote capabilities.

  ltpi-support-i2c-echo:
    description: |
      Enabling I2C echo support in SCM local capabilities.
      Configuring the I2C echo support in the local capability register
      based on the HPM remote capabilities.

  ltpi-support-uart-flow-control:
    description: |
      Enabling UART flow control support in SCM local capabilities.
      Configuring the UART flow control support in the local capability
      register based on the HPM remote capabilities.

  ltpi-support-uart0:
    description: |
      Enabling uart0 support in SCM local capabilities.
      Configuring the local capability register based on the
      HPM remote capabilities.

  ltpi-support-uart1:
    description: |
      Enabling uart1 support in SCM local capabilities.
      Configuring the local capability register based on the
      HPM remote capabilities.

required:
  - compatible
  - reg
  - gpio-controller
  - '#gpio-cells'
  - interrupt-controller
  - '#interrupt-cells'
  - interrupts
  - ngpios
  - dout-init
  - ltpi-support-gpio
  - ltpi-support-i2c
  - ltpi-support-uart
  - ltpi-support-data
  - ltpi-support-nl-gpio-count
  - ltpi-support-i2c-channels
  - ltpi-support-i2c-echo
  - ltpi-support-uart-flow-control
  - ltpi-support-uart0
  - ltpi-support-uart1

additionalProperties: false

examples:
  - |
    #include <dt-bindings/interrupt-controller/irq.h>

    mfd_ltpi0: ltpi@8000 {
        compatible = "axiado,ltpi";
        reg = <0x8000 0x2000>;
        gpio-controller;
        #gpio-cells = <2>;
        interrupt-controller;
        #interrupt-cells = <2>;
        interrupt-parent = <&gpio6>;
        interrupts = <18 IRQ_TYPE_LEVEL_HIGH>;
        ngpios = <128>;
        dout-init = <0x00000000 0x00000000>;
        ltpi-support-gpio;
        ltpi-support-i2c;
        ltpi-support-uart;
        ltpi-support-data;
        /* Number of NL GPIOs to be supported */
        /* SCM supports maximum 128 bits - 0x80 */
        ltpi-support-nl-gpio-count = <0x80>;
        /* LTPI - I2C supporting channels */
        /* bit 0 - ch 0, bit 1 - ch 1, ... */
        /* SCM supports maximum 6 channels */
        ltpi-support-i2c-channels = <0x3F>;
        /* LTPI - I2C Echo support */
        ltpi-support-i2c-echo;
        ltpi-support-uart0;
    };
```

## Documentation/devicetree/bindings/mailbox/axiado,axiado-mailbox.yaml
```yaml
# SPDX-License-Identifier: (GPL-2.0-only OR BSD-2-Clause)
%YAML 1.2
---
$id: http://devicetree.org/schemas/mailbox/axiado,axiado-mailbox.yaml#
$schema: http://devicetree.org/meta-schemas/core.yaml#

title: Axiado SoC Mailbox Controller

maintainers:
  - Krishnakumar Kesavan <kkesavan@axiado.com>
  - Prasad Bolisetty <pbolisetty@axiado.com>

description: |
  The Axiado mailbox controller provides inter-processor communication
  channels between subsystems within the Axiado SoC. The hardware has
  separate TX and RX register regions. Only the RX channels (channels 8–15)
  generate interrupts; TX channels are purely poll/write-based.

properties:
  compatible:
    const: axiado,axiado-mailbox

  reg:
    items:
      - description: TX mailbox register region
      - description: RX mailbox register region

  reg-names:
    items:
      - const: tx
      - const: rx

  interrupts:
    description: |
      One interrupt per RX channel. The hardware exposes eight RX interrupt
      lines corresponding to channels 8 through 15.
    minItems: 1
    maxItems: 8

  interrupt-names:
    description: |
      Named interrupt lines for each RX channel, from ch8 to ch15.
    items:
      - const: ch8
      - const: ch9
      - const: ch10
      - const: ch11
      - const: ch12
      - const: ch13
      - const: ch14
      - const: ch15
    minItems: 1
    maxItems: 8

  interrupt-parent:
    description: Phandle to the parent interrupt controller (e.g. GIC).

  "#mbox-cells":
    description: |
      Number of cells in a mailbox specifier. A single cell encodes the
      channel index as seen by the client.
    const: 1

  "#interrupt-cells":
    description: Number of cells in an interrupt specifier for this controller.
    const: 1

  status: true

required:
  - compatible
  - reg
  - reg-names
  - interrupts
  - interrupt-names
  - "#mbox-cells"

additionalProperties: false

examples:
  - |
    #include <dt-bindings/interrupt-controller/arm-gic.h>

    mailbox0: mailbox@330f2000 {
        compatible = "axiado,axiado-mailbox";
        reg = <0x0 0x330f2000 0x0 0x2000>,
              <0x0 0x331b0000 0x0 0x1000>;
        reg-names = "tx", "rx";
        /* Only RX channels (8-15) have IRQs */
        interrupts = <GIC_SPI 242 IRQ_TYPE_LEVEL_HIGH>,
                     <GIC_SPI 243 IRQ_TYPE_LEVEL_HIGH>,
                     <GIC_SPI 244 IRQ_TYPE_LEVEL_HIGH>,
                     <GIC_SPI 245 IRQ_TYPE_LEVEL_HIGH>,
                     <GIC_SPI 246 IRQ_TYPE_LEVEL_HIGH>,
                     <GIC_SPI 247 IRQ_TYPE_LEVEL_HIGH>,
                     <GIC_SPI 248 IRQ_TYPE_LEVEL_HIGH>,
                     <GIC_SPI 249 IRQ_TYPE_LEVEL_HIGH>;
        interrupt-names = "ch8", "ch9", "ch10", "ch11",
                          "ch12", "ch13", "ch14", "ch15";
        interrupt-parent = <&gic500>;
        #mbox-cells = <1>;
        #interrupt-cells = <1>;
        status = "okay";
    };
```

## Documentation/devicetree/bindings/media/axiado,ax3000-video.yaml
```yaml
# SPDX-License-Identifier: (GPL-2.0-only OR BSD-2-Clause)
%YAML 1.2
---
$id: http://devicetree.org/schemas/media/axiado,ax3000-video.yaml#
$schema: http://devicetree.org/meta-schemas/core.yaml#

title: Axiado AX3000 Video Controller

maintainers:
  - shubhanginig1505 <shubhangini@axiado.com>
  - Makarand Pawagi <mpawagi@axiado.com>
  - Prasad Bolisetty <pbolisetty@axiado.com>

description: |
  This is the device tree binding for the Axiado AX3000 video controller,
  which is part of the Trusted Control/Compute Unit (TCU).
  It typically provides a display output for a secure, out-of-band
  management console within a server environment.

properties:
  compatible:
    const: axiado,ax3000-video

  memory-region:
    $ref: /schemas/types.yaml#/definitions/phandle-array
    description: |
      Phandle to a reserved-memory node for the video display's frame
      buffer or other related memory.

required:
  - compatible
  - memory-region

additionalProperties: false

examples:
  - |
    video {
        compatible = "axiado,ax3000-video";
        memory-region = <&pci_ep_disp>;
    };
```

## Documentation/devicetree/bindings/mfd/axiado,spi-bridge.yaml
```yaml
# SPDX-License-Identifier: (GPL-2.0-only OR BSD-2-Clause)
%YAML 1.2
---
$id: http://devicetree.org/schemas/mfd/axiado,spi-bridge.yaml#
$schema: http://devicetree.org/meta-schemas/core.yaml#

title: Axiado SPI Bridge MFD Device

maintainers:
  - Tzu-Hao Wei <twei@axiado.com>
  - Swark Yang <syang@axiado.com>
  - Prasad Bolisetty <pbolisetty@axiado.com>

description: |
  The Axiado SPI Bridge is an SPI device that acts as a Multi-Function
  Device (MFD) parent. It provides a regmap interface for register access
  to its child devices and can optionally function as an interrupt
  controller, managing an internal IRQ domain for them.

  Communication with the hardware is handled via a 3-phase SPI transaction:
  - Phase 1 (Bytes 0-3): Address word
  - Phase 2 (Bytes 4-7): Dummy
  - Phase 3 (Bytes 8-11): Data

properties:
  compatible:
    items:
      - enum:
          - axiado,ax3000-spi-bridge
      - const: axiado,spi-bridge

  reg:
    maxItems: 1
    description: SPI chip select number

  spi-max-frequency:
    description: Maximum SPI bus frequency in Hz
    minimum: 1000000
    maximum: 50000000

  '#address-cells':
    const: 1

  '#size-cells':
    const: 1

  interrupts:
    maxItems: 1
    description:
      The shared interrupt line from the MFD bridge that signals events
      (e.g., from child devices) to the main processor.

  interrupt-names:
    items:
      - const: mfd-shared

  interrupt-controller:
    description: Declares this node as an interrupt controller.

  '#interrupt-cells':
    const: 1

patternProperties:
  "^([a-zA-Z][a-zA-Z0-9,-]+)@([0-9a-fA-F])+$":
    type: object
    description: Child device nodes bridged by the MFD.

required:
  - compatible
  - reg

additionalProperties: false

examples:
  - |
    #include <dt-bindings/interrupt-controller/arm-gic.h>

    spi {
      #address-cells = <1>;
      #size-cells = <0>;
      spi-bridge@0 {
          compatible = "axiado,ax3000-spi-bridge", "axiado,spi-bridge";
          reg = <0>;
          spi-max-frequency = <25000000>;
          #address-cells = <1>;
          #size-cells = <1>;

          /* Child devices can be defined here */
          i2c@0 {
              compatible = "xlnx,xps-iic-2.00.a";
              #address-cells = <1>;
              #size-cells = <0>;
              reg = <0x0 0x800>;
              clocks = <&foo_clk>;
              interrupt-controller;
              #interrupt-cells = <2>;
              interrupt-parent = <&fake_intc0>;
              interrupts = <11 IRQ_TYPE_LEVEL_HIGH>; /* GPIO_203 I2C slave interrupt */
              clock-frequency = <100000>;
              status = "disabled";
        };
      };
    };
```

## Documentation/devicetree/bindings/misc/axiado,ax-fwupgrade.yaml
```yaml
# SPDX-License-Identifier: (GPL-2.0-only OR BSD-2-Clause)
# Copyright (c) 2025 Axiado Corporation
%YAML 1.2
---
$id: http://devicetree.org/schemas/misc/axiado,ax-fwupgrade.yaml#
$schema: http://devicetree.org/meta-schemas/core.yaml#

title: Axiado Firmware Update Driver

maintainers:
  - Adarsh Kumar <axiado-1509@axiado.com>
  - Sridhar Pothuganti <spothuganti@axiado.com>
  - Prasad Bolisetty <pbolisetty@axiado.com>

description: |
    Axiado firmware upgrade character device. The driver maps a shared memory
    buffer provided via a single MMIO resource and exposes it to userspace via
    mmap() for firmware update operations. The node must supply one memory
    resource describing the buffer address and size.

properties:
  compatible:
    const: axiado,ax-fwupgrade

  reg:
    maxItems: 1
    description:
      MMIO region for the shared data buffer used during firmware upgrade.

required:
  - compatible
  - reg

additionalProperties: false

examples:
  - |
    soc{
        #address-cells = <2>;
        #size-cells = <2>;

        update: fw-update@4A00000 {
                    compatible = "axiado,ax-fwupgrade";
                    reg = <0x00000000 0x04A00000 0x00000000 0x8000000>;
                    status = "okay";
        };
    };
```
