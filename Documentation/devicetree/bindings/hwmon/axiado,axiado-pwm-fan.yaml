## Documentation/devicetree/bindings/hwmon/axiado,axiado-pwm-fan.yaml
```yaml
# SPDX-License-Identifier: (GPL-2.0-only OR BSD-2-Clause)
%YAML 1.2
---
$id: http://devicetree.org/schemas/hwmon/axiado,axiado-pwm-fan.yaml#
$schema: http://devicetree.org/meta-schemas/core.yaml#

title: Axiado AX3000 PWM

maintainers:
  - Akhila Kavi <akavi@axiado.com>
  - Makarand Pawagi <mpawagi@axiado.com>

description: |+
  Bindings for PWM Fan on Axiado AX3000 SoC.

  - compatible:         Should be one of the following:
                        "axiado,ax3000-pwm-fan"
  - reg:
      maxItems: 1

properties:
  compatible:
    enum:
      - axiado,ax3000-pwm-fan

  reg:
    maxItems: 1

  interrupts:
    maxItems: 1
    description: IRQ for the Capture device

  pwms:
    maxItems: 1

required:
  - compatible
  - reg
  - pwms
additionalProperties: false

examples:
  - |
     fan0: pwm-fan@80501400 {
        compatible = "axiado,ax3000-pwm-fan";
        interrupt-parent = <&gic500>;
        interrupts = <00 150 1>;
        reg = <0x80501400 0x00 >;
        pwms = <&pwm0 0 400>;
      };
...
```

## Documentation/devicetree/bindings/i2c/axiado,ax3000-i2c.yaml
```yaml
# SPDX-License-Identifier: (GPL-2.0-only OR BSD-2-Clause)
%YAML 1.2
---
$id: http://devicetree.org/schemas/i2c/axiado,ax3000-i2c.yaml#
$schema: http://devicetree.org/meta-schemas/core.yaml#

title: Axiado AX3000 I2C Controller

maintainers:
  - Tzu-Hao Wei <twei@axiado.com>
  - Swark Yang <syang@axiado.com>
  - Prasad Bolisetty <pbolisetty@axiado.com>

properties:
  compatible:
    const: "axiado,ax3000-i2c"

  clocks:
    minItems: 2
    maxItems: 2

  clock-names:
    items:
      - const: ref   # Reference clock
      - const: xin   # External input clock

  reg:
    maxItems: 1

# By using allOf and $ref, we inherit all the common properties
# like 'reg', 'interrupts', 'clock-frequency' etc. from the base
# Cadence I2C binding. We only define what's different or specific
# to the Axiado device here.
allOf:
  - $ref: /schemas/i2c/i2c-controller.yaml#

unevaluatedProperties: false

required:
  - compatible
  - reg
  - interrupts
  - clocks
  - clock-names

examples:
  - |
    #include <dt-bindings/interrupt-controller/irq.h>

    soc {
        #address-cells = <1>;
        #size-cells = <1>;

        clock_ref: clock-controller-ref {
            compatible = "fixed-clock";
            #clock-cells = <0>;
            clock-frequency = <100000000>;
        };

        clock_xin: clock-controller-xin {
            compatible = "fixed-clock";
            #clock-cells = <0>;
            clock-frequency = <25000000>;
        };

        gpio6: gpio-controller@ff0a0000 {
            compatible = "some-gpio-controller";
            reg = <0xff0a0000 0x1000>;
            gpio-controller;
            #gpio-cells = <2>;
            interrupt-controller;
            #interrupt-cells = <2>;
        };

        i2c@0 {
            compatible = "axiado,ax3000-i2c";
            reg = <0x0 0x800>;
            interrupt-parent = <&gpio6>;
            interrupts = <11 IRQ_TYPE_LEVEL_HIGH>;
            clocks = <&clock_ref>, <&clock_xin>;
            clock-names = "ref", "xin";
            clock-frequency = <100000>;

            #address-cells = <1>;
            #size-cells = <0>;

            eeprom@50 {
                compatible = "atmel,24c02";
                reg = <0x50>;
            };
        };
    };
```

## Documentation/devicetree/bindings/i2c/axiado,xps-iic-slave.yaml
```yaml
# SPDX-License-Identifier: (GPL-2.0-only OR BSD-2-Clause)
%YAML 1.2
---
$id: http://devicetree.org/schemas/i2c/axiado,xps-iic-slave.yaml#
$schema: http://devicetree.org/meta-schemas/core.yaml#

title: Axiado XIIC I2C Slave Controller

maintainers:
  - Petar Stepanovic <pstepanovic@axiado.com>
  - Tzu-Hao Wei <twei@axiado.com>
  - Swark Yang <syang@axiado.com>
  - Prasad Bolisetty <pbolisetty@axiado.com>

description: |
  Axiado I²C slave-only controller derived from the Xilinx XIIC IP core.
  The driver accesses this device through a regmap interface, typically provided
  by a parent device such as an MFD, but not strictly required.

properties:
  compatible:
    const: axiado,xps-iic-slave

  reg:
    maxItems: 1
    description: Base offset within the parent regmap.

  interrupts:
    maxItems: 1

  axiado,irq-rt-priority:
    $ref: /schemas/types.yaml#/definitions/uint32
    description:
      Real-time SCHED_FIFO priority for the threaded IRQ handler.
      Valid range is 1–99. If omitted, a default priority is used.
    minimum: 1
    maximum: 99

  axiado,irq-cpu:
    $ref: /schemas/types.yaml#/definitions/uint32
    description:
      CPU index (0-based) to pin the IRQ worker thread to.
      If omitted, the driver will not override CPU affinity.
    minimum: 0

required:
  - compatible
  - reg
  - interrupts

additionalProperties: false

examples:
  - |
    #include <dt-bindings/interrupt-controller/irq.h>

    spi-bridge@0 {
        compatible = "axiado,ax3000-spi-bridge", "axiado,spi-bridge";
        reg = <0x0 0x1000>;
        #address-cells = <1>;
        #size-cells = <1>;
        interrupt-parent = <&gpio6>;
        interrupts = <20 IRQ_TYPE_LEVEL_HIGH>;
        status = "disabled";

        i2c-ssif@0 {
            compatible = "axiado,xps-iic-slave";
            reg = <0x0 0x800>;
            interrupt-parent = <&gpio6>;
            interrupts = <11 IRQ_TYPE_LEVEL_HIGH>;
            status = "disabled";
        };
    };
```

## Documentation/devicetree/bindings/iio/adc/axiado,ax3000-saradc.yaml
```yaml
# SPDX-License-Identifier: (GPL-2.0-only OR BSD-2-Clause)
%YAML 1.2
---
$id: http://devicetree.org/schemas/iio/adc/axiado,ax3000-saradc.yaml#
$schema: http://devicetree.org/meta-schemas/core.yaml#

title: AXIADO AX3000 SARADC

maintainers:
  - Krishnakumar Kesavan <kkesavan@axiado.com>
  - Akhila Kavi <akavi@axiado.com>
  - Makarand Pawagi <mpawagi@axiado.com>
  - Prasad Bolisetty <pbolisetty@axiado.com>

properties:
  compatible:
    oneOf:
      - items:
          - const: axiado,ax3000-saradc

  reg:
    maxItems: 1

  interrupts:
    maxItems: 1

  clocks:
    maxItems: 1

  clock-names:
    items:
      - const: refclk   # Reference clock

  '#io-channel-cells':
    const: 1

required:
  - compatible
  - reg
  - interrupts
  - clocks
  - '#io-channel-cells'

additionalProperties: false

examples:
  - |
    saradc: saradc@806A0000 {
      compatible = "axiado,ax3000-saradc";
      reg = <0x00 0x806A0000 0x00 0x400>;
      interrupts = <0 166 1>;
      clocks = <&refclk>;
      clock-names = "refclk";
      #io-channel-cells = <1>;
      status = "disabled";
      };
```

## Documentation/devicetree/bindings/ipmi/axiado,ax3000-kcs-bmc.yaml
```yaml
# SPDX-License-Identifier: (GPL-2.0-only OR BSD-2-Clause)
%YAML 1.2
---
$id: http://devicetree.org/schemas/ipmi/axiado,ax3000-kcs-bmc.yaml#
$schema: http://devicetree.org/meta-schemas/core.yaml#

title: Axiado KCS IPMI BMC Interface

maintainers:
  - Satya Jena <sjena@axiado.com>
  - Makarand Pawagi <mpawagi@axiado.com>
  - Prasad Bolisetty <pbolisetty@axiado.com>

description: |
  The Axiado KCS BMC device provides a Keyboard Controller Style (KCS)
  interface for IPMI (Intelligent Platform Management Interface) communication
  between a host system and a BMC (Baseboard Management Controller).

  This driver implements the KCS protocol as defined in the IPMI specification
  and uses Axiado's eSPI ATU (Address Translation Unit) for host I/O address
  mapping to internal registers.

  The KCS interface supports standard IPMI operations and provides a character
  device interface (/dev/ipmi-kcs<N>) for userspace IPMI applications.

properties:
  compatible:
    const: axiado,ax3000-kcs-bmc

  reg:
    maxItems: 1
    description:
      Register offset within the parent eSPI controller's peripheral
      register space. This is not a physical address but an offset
      used with the parent's regmap interface.

  interrupts:
    maxItems: 1
    description:
      Virtual IRQ number from the parent eSPI controller's external
      logic IRQ chip. This is the bit position in the external ISR
      register, not a hardware IRQ number.

  channel-index:
    $ref: /schemas/types.yaml#/definitions/uint32
    minimum: 0
    maximum: 3
    description:
      KCS channel index (0-3). Each channel provides an independent
      KCS interface with its own set of registers and I/O address space.

  io-addr:
    $ref: /schemas/types.yaml#/definitions/uint32
    description: |
      Host I/O port address for this KCS channel. This is the address
      that the host system uses to access the KCS interface. Standard
      IPMI KCS addresses include 0xCA2 (primary) and 0xCA4, 0xCA6,
      0xCA8 (alternate channels).

  host-status-offset:
    $ref: /schemas/types.yaml#/definitions/uint32
    default: 1
    enum: [1, 2, 4, 8, 16]
    description:
      Offset from the data register to the status/command register from
      the host's perspective. This defines the register spacing in the
      host I/O address space. Common values are 1 (consecutive addresses)
      or 4 (DWORD-aligned).

  addr-size:
    $ref: /schemas/types.yaml#/definitions/uint32
    default: 1
    description:
      Size of each register in bytes. Typically 1 byte for standard
      KCS implementations.

required:
  - compatible
  - reg
  - interrupts
  - channel-index
  - io-addr

additionalProperties: false

examples:
  - |
    #include <dt-bindings/interrupt-controller/irq.h>

    espi_kcs0: espi-kcs@0 {
        compatible = "axiado,ax3000-kcs-bmc";
        reg = <0x0 0x10>;
        interrupts = <0>;
        interrupt-parent = <&mfd_espi>;
        channel-index = <0>;
        io-addr = <0xCA2>;
        host-status-offset = <1>;
        addr-size = <1>;
        status = "okay";
    };

    espi_kcs1: espi-kcs@10 {
        compatible = "axiado,ax3000-kcs-bmc";
        reg = <0x10 0x10>;
        interrupts = <1>;
        interrupt-parent = <&mfd_espi>;
        channel-index = <1>;
        io-addr = <0xCA4>;
        host-status-offset = <1>;
        addr-size = <1>;
        status = "disabled";
    };

    espi_kcs2: espi-kcs@20 {
        compatible = "axiado,ax3000-kcs-bmc";
        reg = <0x20 0x10>;
        interrupts = <2>;
        interrupt-parent = <&mfd_espi>;
        channel-index = <2>;
        io-addr = <0xCA6>;
        host-status-offset = <1>;
        addr-size = <1>;
        status = "disabled";
    };

    espi_kcs3: espi-kcs@30 {
        compatible = "axiado,ax3000-kcs-bmc";
        reg = <0x30 0x10>;
        interrupts = <3>;
        interrupt-parent = <&mfd_espi>;
        channel-index = <3>;
        io-addr = <0xCA8>;
        host-status-offset = <1>;
        addr-size = <1>;
        status = "disabled";
    };
```
