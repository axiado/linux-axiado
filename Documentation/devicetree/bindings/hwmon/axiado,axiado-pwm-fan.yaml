## Documentation/devicetree/bindings/misc/axiado,ax-ipc.yaml
```yaml
# SPDX-License-Identifier: (GPL-2.0-only OR BSD-2-Clause)
# Copyright (c) 2025 Axiado Corporation
%YAML 1.2
---
$id: http://devicetree.org/schemas/misc/axiado,ax-ipc.yaml#
$schema: http://devicetree.org/meta-schemas/core.yaml#

title: Axiado IPC device

maintainers:
  - Adarsh Kumar <adarsh.kumar@axiado.com>
  - Sridhar Pothuganti <spothuganti@axiado.com>
  - Prasad Bolisetty <pbolisetty@axiado.com>

description: |
  The Axiado AX IPC block provides inter-processor communication between
  the main CPU (A53/A55) and the secure M0/RPU core. It exposes multiple
  memory-mapped regions containing shared memory, IPC registers, and
  status scratchpad areas. It also uses an interrupt line for signaling
  between processors.

properties:
  compatible:
    const: axiado,ax-ipc

  reg:
    minItems: 6
    maxItems: 6
    description: |
      List of MMIO regions used by the IPC block:
        0. Shared memory region
        1. TX interrupt register
        2. RX interrupt register
        3. Data buffer region for A53->M0 transfer
        4. Scratchpad register for boot/status
        5. Scratchpad/MMC partition region

  memory-region:
    description: Reserved memory for IPC shared data
    $ref: /schemas/types.yaml#/definitions/phandle

  interrupts:
    maxItems: 1
    description: IPC interrupt from M0 to CPU

  "#interrupt-cells":
    const: 1

required:
  - compatible
  - reg
  - interrupts
  - memory-region

additionalProperties: false

examples:
  - |
    soc {
        #address-cells = <2>;
        #size-cells = <2>;

        ipc0: m0-ipc@4000 {
            compatible = "axiado,ax-ipc";

            reg = <0x0 0x4000 0x0 0x8000>,
                  <0x0 0x88014120 0x0 0x4>,
                  <0x0 0x88014154 0x0 0x4>,
                  <0x0 0x02A00000 0x0 0x100000>,
                  <0x0 0x80620804 0x0 0x4>,
                  <0x0 0x01500000 0x0 0x4>;

            memory-region = <&shared_mem_rsvd_m0>;
            interrupts  = <171>;
            status = "okay";
        };
   };
```

## Documentation/devicetree/bindings/net/axiado,ax3000-hcp.yaml
```yaml
# SPDX-License-Identifier: (GPL-2.0-only OR BSD-2-Clause)
%YAML 1.2
---
$id: http://devicetree.org/schemas/net/axiado,ax3000-hcp.yaml#
$schema: http://devicetree.org/meta-schemas/core.yaml#

title: Axiado AX3000 HCP (Header and Crypto Processing Engine)

maintainers:
  - Satya Jena <sjena@axiado.com>
  - Mirza Aijaz Baig <mbaig@axiado.com>
  - Makarand Pawagi <mpawagi@axiado.com>
  - Prasad Bolisetty <pbolisetty@axiado.com>

description: |
  The Axiado HCP is a unified network and cryptographic subsystem found in
  the Axiado AX3000 SoC. It integrates:
  - 5 Ethernet MACs (one 10Gbps RXAUI, four 1Gbps SGMII/RMII)
  - SHIM packet interface with FIFO-based packet processing
  - Rambus EIP-197 hardware crypto accelerator
  - MDIO bus controller for PHY management

  The driver creates network devices (ethX) based on enabled MAC nodes.

properties:
  compatible:
    const: axiado,ax3000-hcp

  reg:
    items:
      - description: EIP-197 crypto engine registers
      - description: SHIM packet interface registers
      - description: PHY CSR (Control and Status Registers)

  reg-names:
    items:
      - const: eip197
      - const: shim
      - const: phy-csr

  interrupts:
    description: |
      Interrupt lines for HCP subsystem. The list is positional and must
      be in the exact order shown below (and match interrupt-names).
    items:
      - description: EIP-197 crypto engine
      - description: EIP Ring interface 0
      - description: EIP Ring interface 1
      - description: EIP Ring interface 2
      - description: EIP Ring interface 3
      - description: MAC interface 0
      - description: MAC interface 1
      - description: MAC interface 2
      - description: MAC interface 3
      - description: MAC interface 4
      - description: EIP Ring interface 4
      - description: EIP Ring interface 5
      - description: EIP Ring interface 6
      - description: EIP Ring interface 7
      - description: EIP Ring interface 8
      - description: EIP Ring interface 9
      - description: EIP Ring interface 10
      - description: EIP Ring interface 11

  interrupt-names:
    items:
      - const: eip197
      - const: eip_ring0
      - const: eip_ring1
      - const: eip_ring2
      - const: eip_ring3
      - const: xgmii
      - const: gmii0
      - const: gmii1
      - const: gmii2
      - const: gmii3
      - const: eip_ring4
      - const: eip_ring5
      - const: eip_ring6
      - const: eip_ring7
      - const: eip_ring8
      - const: eip_ring9
      - const: eip_ring10
      - const: eip_ring11

  clocks:
    maxItems: 1
    description: Optional EIP-197 clock

  clock-names:
    items:
      - const: eip197

  '#address-cells':
    const: 1

  '#size-cells':
    const: 0

  mdio:
    type: object
    $ref: /schemas/net/mdio.yaml#
    description: |
      MDIO bus controller for managing external PHY devices.

    properties:
      compatible:
        const: axiado,ax3000-mdio

    required:
      - compatible

    unevaluatedProperties: false

patternProperties:
  '^mac@[0-4]$':
    type: object
    $ref: ethernet-controller.yaml#
    description: |
      Ethernet MAC interface nodes. Each MAC can be independently enabled/
      disabled and configured via device tree. MACs with status="okay" are
      initialized; MACs with status="disabled" are skipped.

    properties:
      compatible:
        const: axiado,ax3000-mac

      reg:
        maxItems: 1
        description: MAC index (0-4)

      phy-mode:
        description: PHY interface mode
        enum:
          - rxaui
          - sgmii
          - rmii

      phy-handle:
        description: |
          Phandle to external PHY device on MDIO bus. If absent, MAC uses
          internal PHY in SGMII mode or in other modes based on additional
          settings when the MAC is enabled.

    required:
      - compatible
      - reg
      - phy-mode

    unevaluatedProperties: false

required:
  - compatible
  - reg
  - reg-names
  - interrupts
  - interrupt-names

additionalProperties: false

examples:
  - |
    #include <dt-bindings/interrupt-controller/irq.h>
    #include <dt-bindings/interrupt-controller/arm-gic.h>

    soc {
        #address-cells = <1>;
        #size-cells = <1>;

        hcp@83000000 {
            compatible = "axiado,ax3000-hcp";
            reg = <0x83000000 0x100000>,  /* EIP-197: 1MB */
                  <0x83100000 0x4000>,    /* SHIM: 16KB */
                  <0x87000000 0x50000>;   /* PHY CSR: 320KB */
            reg-names = "eip197", "shim", "phy-csr";

            interrupt-parent = <&gic500>;
            interrupts = <GIC_SPI 32 IRQ_TYPE_LEVEL_HIGH>,  /* EIP-197 */
                     <GIC_SPI 1 IRQ_TYPE_LEVEL_HIGH>,   /* Ring 0 */
                     <GIC_SPI 2 IRQ_TYPE_LEVEL_HIGH>,   /* Ring 1 */
                     <GIC_SPI 3 IRQ_TYPE_LEVEL_HIGH>,   /* Ring 2 */
                     <GIC_SPI 4 IRQ_TYPE_LEVEL_HIGH>,   /* Ring 3 */
                     <GIC_SPI 5 IRQ_TYPE_LEVEL_HIGH>,   /* MAC 0 */
                     <GIC_SPI 6 IRQ_TYPE_LEVEL_HIGH>,   /* MAC 1 */
                     <GIC_SPI 7 IRQ_TYPE_LEVEL_HIGH>,   /* MAC 2 */
                     <GIC_SPI 8 IRQ_TYPE_LEVEL_HIGH>,   /* MAC 3 */
                     <GIC_SPI 9 IRQ_TYPE_LEVEL_HIGH>;   /* MAC 4 */
            interrupt-names = "eip197", "ring0", "ring1", "ring2", "ring3",
                              "mac0", "mac1", "mac2", "mac3", "mac4";

            clocks = <&clk_eip197>;
            clock-names = "eip197";

            #address-cells = <1>;
            #size-cells = <0>;

            /* 10G RXAUI MAC - eth1 */
            mac@0 {
                compatible = "axiado,ax3000-mac";
                reg = <0>;
                phy-mode = "rxaui";
                phy-handle = <&phy0>;
                status = "okay";
            };

            /* 1G SGMII MAC - eth0 (primary) */
            mac@4 {
                compatible = "axiado,ax3000-mac";
                reg = <4>;
                phy-mode = "sgmii";
                phy-handle = <&phy4>;
                status = "okay";
            };

            /* Other MACs disabled */
            mac@1 {
                compatible = "axiado,ax3000-mac";
                reg = <1>;
                phy-mode = "sgmii";
                status = "disabled";
            };

            mac@2 {
                compatible = "axiado,ax3000-mac";
                reg = <2>;
                phy-mode = "sgmii";
                status = "disabled";
            };

            mac@3 {
                compatible = "axiado,ax3000-mac";
                reg = <3>;
                phy-mode = "sgmii";
                status = "disabled";
            };

            /* MDIO bus */
            mdio {
                compatible = "axiado,ax3000-mdio";
                #address-cells = <1>;
                #size-cells = <0>;

                phy0: ethernet-phy@0 {
                    reg = <0>;
                    compatible = "ethernet-phy-ieee802.3-c22";
                };

                phy4: ethernet-phy@4 {
                    reg = <4>;
                    compatible = "ethernet-phy-ieee802.3-c22";
                };
            };
        };
    };
```

## Documentation/devicetree/bindings/net/axiado,axiado-mctp-mailbox.yaml
```yaml
# SPDX-License-Identifier: GPL-2.0 OR BSD-2-Clause
%YAML 1.2
---
$id: http://devicetree.org/schemas/net/axiado,axiado-mctp-mailbox.yaml#
$schema: http://devicetree.org/meta-schemas/core.yaml#

title: Axiado MCTP over Mailbox Transport

maintainers:
  - Sammai Chakravarthy <schakravarthy@axiado.com>
  - Sridhar Pothuganti <spothuganti@axiado.com>
  - Prasad Bolisetty <pbolisetty@axiado.com>

description:
  MCTP transport driver for Axiado AX3005 SoC. Packets are
  framed with a 16-byte firmware header (ax_ipc_mb_msg_t:
  len, type, priority, flag - each a 32-bit little-endian
  word) followed by the raw MCTP payload. The mailbox FIFO
  is fixed at 252 bytes, yielding a maximum MCTP payload of
  236 bytes, which satisfies the DMTF DSP0236 Section 8.3
  minimum MTU of 68 bytes.

properties:
  compatible:
    const: axiado,ax3005-mctp-mailbox

  mboxes:
    description:
      Phandle and channel index of the mailbox channel used for MCTP
      message transport.
    maxItems: 2

  mbox-names:
    description:
      Name of the mailbox channel used for MCTP transport.
    items:
      - const: tx
      - const: rx

  status:
    description:
      Standard device status property.

required:
  - compatible
  - mboxes
  - mbox-names

additionalProperties: false

examples:
  - |
    mctp-mailbox {
        compatible = "axiado,axiado-mctp-mailbox";
        mboxes = <&mailbox0 0>,
                 <&mailbox0 8>;
        mbox-names = "tx", "rx";
    };
```

## Documentation/devicetree/bindings/pci/axiado,ax3000-pcie.yaml
```yaml
# SPDX-License-Identifier: (GPL-2.0-only OR BSD-2-Clause)
%YAML 1.2
---
$id: http://devicetree.org/schemas/pci/axiado,ax3000-pcie.yaml#
$schema: http://devicetree.org/meta-schemas/core.yaml#

title: Axiado PCIe controller (PLDA IP based)

maintainers:
  - Shubhangini G <shubhangini@axiado.com>
  - Makarand Pawagi <mpawagi@axiado.com>
  - Prasad Bolisetty <pbolisetty@axiado.com>

description: |
  This PCIe controller is based on the PLDA XpressRich PCIe IP.
  The controller instances are dual mode where in they can work either in
  Root Port mode or Endpoint mode but one at a time.

allOf:
  - $ref: /schemas/pci/pci-host-bridge.yaml#

properties:
  compatible:
    enum:
      - axiado,ax3000-pcie

  device_role:
    description: |
       code for the pcie role.
       - "host": PCIe Host
       - "vga": PCIe VGA
       - "eth": PCIe ETH
    items:
      enum: [ host, vga, eth ]
    $ref: /schemas/types.yaml#/definitions/non-unique-string-array

  num-lanes:
    description: |
      number of lanes to use
    $ref: /schemas/types.yaml#/definitions/uint32
    minimum: 1
    maximum: 2

  reg:
    description: |
      Register definitions for the controller's various blocks.
    items:
      - description: controller's configuration registers
      - description: phy configuration registers
      - description: aperture to access configuration space
      - description: mailbox configuration registers
      - description: ioctl configuration registers
      - description: ext configuration registers
    minItems: 6

  reg-names:
    items:
      - const: csr
      - const: phy
      - const: cfg
      - const: mbx
      - const: ioctl
      - const: ext

  interrupts:
    items:
      - description: MSI interrupt

  interrupt-names:
    items:
      - const: msi

  clocks:
    items:
      - description: module clock

  clock-names:
    items:
      - const: clk_pclk

  bus-range:
    maxItems: 2

  ranges:
    description: PCI address ranges for I/O, memory, and prefetchable memory

  '#address-cells':
    const: 3

  '#size-cells':
    const: 2


unevaluatedProperties: false

required:
  - compatible
  - device_type
  - reg
  - reg-names
  - interrupts
  - interrupt-names
  - interrupt-map
  - interrupt-map-mask
  - clocks
  - clock-names
  - num-lanes
  - bus-range
  - ranges
  - "#address-cells"
  - "#size-cells"

examples:
  - |

    #include <dt-bindings/interrupt-controller/irq.h>
    #include <dt-bindings/interrupt-controller/arm-gic.h>
    soc@0 {
        #address-cells = <2>;
        #size-cells = <2>;
        ranges = <0x0 0x0 0x0 0x0 0x0>;
        pcie_x1: pcie@85200000 {
                        compatible = "axiado,ax3000-pcie";
                        status = "disabled";
                        device_type = "pci";
                        device_role = "vga"; /* VGA EP */
                        reg = <0 0x85200000 0 0x1000 /* CSR reg */
                               0 0x85300000 0 0x4000 /* PHY reg */
                               0 0x85202000 0 0x1000 /* CFG space */
                               0 0x85280000 0 0x80000 /* MBX reg */
                               0 0x80702400 0 0x100 /* IOCTL reg */
                               0 0x85240000 0 0x1000>; /* EXT reg */
                        reg-names = "csr", "phy", "cfg", "mbx", "ioctl", "ext";
                        #address-cells = <3>;
                        #size-cells = <2>;
                        interrupts = <GIC_SPI 33 IRQ_TYPE_LEVEL_HIGH>; /* MSI interrupt */
                        interrupt-names = "msi";
                        interrupt-map-mask = <0 0 0 7>;
                        interrupt-map = <0 0 0 1 &gic500 0>, /* int_a */
                                        <0 0 0 2 &gic500 1>, /* int_b */
                                        <0 0 0 3 &gic500 2>, /* int_c */
                                        <0 0 0 4 &gic500 3>; /* int_d */
                        num-lanes = <1>;
                        clocks = <&clk_pclk> ;
                        clock-names = "clk_pclk";
                        bus-range = <0x00 0xff>;
                        ranges = <0x83000000 0x3 0xE0000000 0x3 0xE0000000 0x0 0x400000
                                 0x82000000 0x0 0x90000000 0x0 0x90000000 0x0 0x8000000
                                 0xc2000000 0x0 0x98000000 0x0 0x98000000 0x0 0x100000>;

                        pci0: pci@1,0 {
                                device_type = "pci";
                                assigned-addresses = <0x83000800 0x3 0xE0000000 0 0x400000>;
                                reg = <0x00800 0 0 0 0>;
                                #address-cells = <3>;
                                #size-cells = <2>;
                                ranges;
                        };
                };
        };
```
