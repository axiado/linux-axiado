## drivers/pci/controller/plda/Kconfig
```kconfig
# SPDX-License-Identifier: GPL-2.0

menu "PLDA-based PCIe controllers"
	depends on PCI

config PCIE_PLDA_HOST
	bool
	select IRQ_MSI_LIB

config PCIE_AXIADO_EP_MODE
	bool
	depends on ARCH_AXIADO && (OF || COMPILE_TEST)

config PCIE_AXIADO_END_POINT
	bool "Axiado PCIe end point Controller (legacy)"
	depends on PCI_MSI
	depends on PCI
	depends on ARCH_AXIADO && (OF || COMPILE_TEST)
	depends on !PCIE_AXIADO_EPC
	select PCI_HOST_COMMON
	select PCIE_PLDA_HOST
	select PCIE_AXIADO_EP_MODE
	help
	  Say Y if you want PCIe End-point Support on Axiado SoCs
	  using the legacy host-bridge based endpoint driver.

config PCIE_AXIADO_EPC
	bool "Axiado PCIe Endpoint Controller (EPC framework)"
	depends on PCI
	depends on PCI_ENDPOINT
	depends on ARCH_AXIADO && (OF || COMPILE_TEST)
	select PCIE_AXIADO_EP_MODE
	help
	  Say Y here to enable the PCIe Endpoint Controller (EPC) driver
	  for Axiado AX3000 and AX3005 SoCs.  The driver integrates the
	  PLDA XpressRich PCIe IP in endpoint mode with the Linux pci_epc
	  framework, providing standard BAR configuration, MSI interrupt
	  generation, and PCIe-to-AXI address translation.

	  This is the preferred endpoint driver; the legacy
	  PCIE_AXIADO_END_POINT option is deprecated.

	  If unsure, say N.

config PCIE_MICROCHIP_HOST
	tristate "Microchip AXI PCIe controller"
	depends on PCI_MSI && OF
	select PCI_HOST_COMMON
	select PCIE_PLDA_HOST
	help
	  Say Y here if you want kernel to support the Microchip AXI PCIe
	  Host Bridge driver.

config PCIE_STARFIVE_HOST
	tristate "StarFive PCIe host controller"
	depends on PCI_MSI && OF
	depends on ARCH_STARFIVE || COMPILE_TEST
	select PCIE_PLDA_HOST
	help
	  Say Y here if you want to support the StarFive PCIe controller in
	  host mode. StarFive PCIe controller uses PLDA PCIe core.

	  If you choose to build this driver as module it will be dynamically
	  linked and module will be called pcie-starfive.ko.

endmenu
```

## drivers/soc/axiado/Kconfig
```kconfig
# SPDX-License-Identifier: GPL-2.0-only
#
# Axiado SoC drivers
#
menu "AXIADO SoC drivers"
	depends on ARCH_AXIADO || COMPILE_TEST

config AXIADO_SGPIO
	bool "Axiado SGPIO support"
	depends on OF_GPIO
	select GPIO_GENERIC
	select GPIOLIB_IRQCHIP
	help
	  Enable support for Axiado Serial GPIO (SGPIO) controller.
	  SGPIO provides a serial interface for GPIO operations with support
	  for interrupt handling, and configurable data direction.
	  This driver supports both 128-bit design variants
	  and can work with either direct memory mapping
	  or regmap-based register access.

config AXIADO_SGPIO_REGMAP
	bool "Axiado SGPIO regmap support"
	depends on AXIADO_SGPIO
	select REGMAP
	help
	  Enable regmap support for Axiado SGPIO driver.
	  This option allows the SGPIO driver to work with MFD framework
	  using regmap for register access instead of direct
	  memory mapping. When enabled, the driver will attempt to use regmap
	  from the parent device for register operations, falling back to
	  direct memory mapping if regmap is not available. This is useful
	  when SGPIO is part of a larger MFD device with shared register space.

config AXIADO_ESPI
	tristate "Axiado eSPI Slave Controller support"
	select REGMAP
	select REGMAP_MMIO
	select REGMAP_IRQ
	help
	  Enable support for the Axiado eSPI slave controller.

	  The eSPI controller provides communication between the host and the BMC
	  over the eSPI interface, supporting peripheral, virtual wire, out-of-band,
	  and flash channels.

	  The driver supports direct MMIO mode based on the device tree compatible string.

config AXIADO_ESPI_SNOOP
	tristate "AXIADO ESPI SNOOP support"
	depends on AXIADO_ESPI
	select REGMAP
	help
	  This driver provides support for the Axiado eSPI Snoop interface
	  which captures POST codes (Port 80 data) sent by the host via eSPI.

	  It exposes a character device (/dev/axiado-espi-snoop) for user
	  space tools such as snoopd to monitor POST code updates.

	  If unsure, say N.

endmenu
```

## drivers/usb/gadget/udc/crg/Kconfig
```kconfig
# SPDX-License-Identifier: GPL-2.0
config USB_CRG_UDC
	tristate "Corigine / Axiado USB Device Controller"
	depends on USB_GADGET
	depends on HAS_DMA
	depends on ARCH_AXIADO || COMPILE_TEST
	help
	  Say Y here to support the USB device controller found on Axiado AX3000
	  and AX3005 SoCs, which is based on the Corigine USB 3.1 IP.

	  This controller supports High-Speed and SuperSpeed.

	  Say "y" to link the driver statically, or "m" to build a
	  dynamically linked module called "crg-udc.ko".

	  If unsure, say N.
```
