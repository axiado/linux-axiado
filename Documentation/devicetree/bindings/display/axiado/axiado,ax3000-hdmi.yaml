## Documentation/devicetree/bindings/display/axiado/axiado,ax3000-hdmi.yaml
```yaml
# SPDX-License-Identifier: (GPL-2.0-only OR BSD-2-Clause)
%YAML 1.2
---
$id: http://devicetree.org/schemas/display/axiado/axiado,ax3000-hdmi.yaml#
$schema: http://devicetree.org/meta-schemas/core.yaml#

title: Axiado AX3000 HDMI TX Encoder

maintainers:
  - Shubhangini G <shubhangini@axiado.com>
  - Tzu-Hao Wei <twei@axiado.com>
  - Prasad Bolisetty <pbolisetty@axiado.com>

description: |
  The HDMI transmitter is an Innosilicon HDMI TX controller IP
  with a companion PHY IP, integrated on the Axiado AX3000 SoC.

properties:
  compatible:
    const: axiado,ax3000-hdmi

  reg:
    maxItems: 1

  memory-region:
    maxItems: 1
    description: |
      Reserved memory region used as an EDID passthrough buffer when
      'axiado,hypervisor-edid-passthrough' is present.

  clocks:
    maxItems: 1
    description:
      Pixel clock for the HDMI controller; sets the TMDS reference.

  clock-names:
    items:
      - const: clk_pclk

  interrupts:
    maxItems: 1

  pwren-gpios:
    maxItems: 1
    description:
      Optional GPIO that controls the HDMI power rail. When present the
      driver asserts it high at bind time before initialising the PHY.

  axiado,hypervisor-edid-passthrough:
    type: boolean
    description: |
      When set, the driver mirrors the EDID bytes read from the sink
      into the reserved 'memory-region' so the hypervisor BMC can
      observe what monitor is attached.

  ports:
    $ref: /schemas/graph.yaml#/properties/ports

    properties:
      port@0:
        $ref: /schemas/graph.yaml#/properties/port
        description:
          Input port; one endpoint connected to the LCDC output.

    required:
      - port@0

required:
  - compatible
  - reg
  - clocks
  - clock-names
  - interrupts
  - ports

additionalProperties: false

examples:
  - |
    #include <dt-bindings/interrupt-controller/arm-gic.h>
    #include <dt-bindings/interrupt-controller/irq.h>

    hdmi@40c11000 {
        compatible = "axiado,ax3000-hdmi";
        reg = <0x40c11000 0x4000>;
        interrupts = <GIC_SPI 16 IRQ_TYPE_LEVEL_HIGH>;
        clocks = <&clk_pclk>;
        clock-names = "clk_pclk";

        ports {
            #address-cells = <1>;
            #size-cells = <0>;

            port@0 {
                reg = <0>;
                hdmi_in_disp: endpoint {
                    remote-endpoint = <&disp_out_hdmi>;
                };
            };
        };
    };
...
```

## Documentation/devicetree/bindings/display/axiado/axiado,db9000-lcdc.yaml
```yaml
# SPDX-License-Identifier: (GPL-2.0-only OR BSD-2-Clause)
%YAML 1.2
---
$id: http://devicetree.org/schemas/display/axiado/axiado,db9000-lcdc.yaml#
$schema: http://devicetree.org/meta-schemas/core.yaml#

title: Digital Blocks DB9000 LCD Controller (Axiado AX3000)

maintainers:
  - Shubhangini G <shubhangini@axiado.com>
  - Tzu-Hao Wei <twei@axiado.com>
  - Prasad Bolisetty <pbolisetty@axiado.com>

description: |
  The DB9000 is a display controller from Digital Blocks integrated on
  the Axiado AX3000 SoC. It reads pixels from a framebuffer in main
  memory and drives a single RGB interface. Output may be formatted in
  RGB or BGR.

properties:
  compatible:
    const: axiado,drm-db9000

  reg:
    maxItems: 1

  interrupts:
    maxItems: 1

  clocks:
    maxItems: 1
    description:
      Pixel clock that drives the LCDC scanout engine and feeds the
      downstream HDMI PHY reference.

  clock-names:
    items:
      - const: clk_pclk

  port:
    $ref: /schemas/graph.yaml#/properties/port
    description: Output port; endpoint connected to the HDMI encoder.

  bits-per-pixel:
    $ref: /schemas/types.yaml#/definitions/uint32
    enum: [16, 24, 32]
    description: |
      Number of bits used to represent a single pixel within the
      controller. Default 24 when omitted.

  bus-width:
    $ref: /schemas/types.yaml#/definitions/uint32
    enum: [8, 16, 24]
    description: |
      Width of the interface to the LCD panel. Required when
      bits-per-pixel is 16 or less but the board connects a 24-bit
      panel; the controller will shift 16-bit data to the MSB of the
      output. Default 24 when omitted.

  memory-region:
    $ref: /schemas/types.yaml#/definitions/phandle
    description: Reserved framebuffer region (fixed physical range).

  paddr-disp:
    $ref: /schemas/types.yaml#/definitions/uint32
    deprecated: true
    description: |
      Historical: offset into the reserved framebuffer region. The
      driver no longer consults this property and derives the DMA
      address from the GEM/DMA helpers instead. Kept in the schema
      only so existing DTS files continue to pass dt-validate; new
      DTS should omit it.

required:
  - compatible
  - reg
  - interrupts
  - clocks
  - clock-names
  - port
  - memory-region

additionalProperties: false

examples:
  - |
    #include <dt-bindings/interrupt-controller/arm-gic.h>
    #include <dt-bindings/interrupt-controller/irq.h>

    disp_ctrl: display-controller@40c00000 {
        compatible = "axiado,drm-db9000";
        reg = <0x40c00000 0x1000>;
        memory-region = <&pci_ep_disp>;
        interrupts = <GIC_SPI 14 IRQ_TYPE_LEVEL_HIGH>;
        clocks = <&clk_pclk>;
        clock-names = "clk_pclk";
        bits-per-pixel = <32>;
        bus-width = <24>;

        disp_out: port {
            disp_out_hdmi: endpoint {
                remote-endpoint = <&hdmi_in_disp>;
            };
        };
    };
...
```

## Documentation/devicetree/bindings/display/axiado/axiado,display-subsystem.yaml
```yaml
# SPDX-License-Identifier: (GPL-2.0-only OR BSD-2-Clause)
%YAML 1.2
---
$id: http://devicetree.org/schemas/display/axiado/axiado,display-subsystem.yaml#
$schema: http://devicetree.org/meta-schemas/core.yaml#

title: Axiado AX3000 Display Subsystem

maintainers:
  - Shubhangini G <shubhangini@axiado.com>
  - Tzu-Hao Wei <twei@axiado.com>
  - Prasad Bolisetty <pbolisetty@axiado.com>

description: |
  Container node for the AX3000 SoC display subsystem. The driver walks
  the 'ports' phandle list to discover the display pipeline components
  (LCDC, HDMI) via the standard device-tree ports/endpoint graph.

properties:
  compatible:
    const: axiado,display-subsystem

  ports:
    $ref: /schemas/types.yaml#/definitions/phandle-array
    description: |
      Phandles to each display-pipeline component's 'port' node. The
      driver uses these as anchors for the OF-graph walk that ties the
      LCDC and HDMI components together via the component framework.
    minItems: 1

  memory-region:
    maxItems: 1
    description: |
      Optional reserved memory region used as the DMA pool for GEM
      buffer allocations. When absent, the platform default DMA pool
      is used instead.

required:
  - compatible
  - ports

additionalProperties: false

examples:
  - |
    display-subsystem {
        compatible = "axiado,display-subsystem";
        ports = <&disp_out>, <&hdmi_in>;
        memory-region = <&pci_ep_disp>;
    };
...
```

## Documentation/devicetree/bindings/gpio/axiado,sgpio.yaml
```yaml
# SPDX-License-Identifier: (GPL-2.0-only OR BSD-2-Clause)
%YAML 1.2
---
$id: http://devicetree.org/schemas/gpio/axiado,sgpio.yaml#
$schema: http://devicetree.org/meta-schemas/core.yaml#

title: Axiado SGPIO Controller

maintainers:
  - Tzu-Hao Wei <twei@axiado.com>
  - Swark Yang <syang@axiado.com>
  - Prasad Bolisetty <pbolisetty@axiado.com>

description: |
  Axiado Serial GPIO (SGPIO) controller provides GPIO expansion using
  serial shift registers. The controller acts as both a GPIO controller
  and an interrupt controller.

properties:
  compatible:
    const: axiado,sgpio

  reg:
    maxItems: 1

  gpio-controller: true

  "#gpio-cells":
    const: 2

  interrupt-controller: true

  "#interrupt-cells":
    const: 2

  interrupts:
    maxItems: 1

  clocks:
    maxItems: 1

  ngpios:
    description:
      Number of GPIOs supported by the controller.
    $ref: /schemas/types.yaml#/definitions/uint32

  bus-frequency:
    description:
      SGPIO shift clock frequency in Hz.
    $ref: /schemas/types.yaml#/definitions/uint32

  apb-frequency:
    description:
      APB bus frequency in Hz.
    $ref: /schemas/types.yaml#/definitions/uint32

  dout-init:
    description:
      Initial output values for the four DOUT registers.
    $ref: /schemas/types.yaml#/definitions/uint32-array
    minItems: 4
    maxItems: 4

  design-variant:
    description:
      Hardware design variant (for example, 128 or 512).
    $ref: /schemas/types.yaml#/definitions/uint32
    enum: [128, 512]

required:
  - compatible
  - reg
  - gpio-controller
  - "#gpio-cells"
  - interrupt-controller
  - "#interrupt-cells"
  - interrupts
  - clocks
  - ngpios
  - bus-frequency
  - apb-frequency
  - dout-init

additionalProperties: false

examples:
  - |
    #include <dt-bindings/interrupt-controller/arm-gic.h>
    #include <dt-bindings/interrupt-controller/irq.h>

    soc {
        #address-cells = <2>;
        #size-cells = <2>;

        sgpio0: sgpio@33201c00 {
            compatible = "axiado,sgpio";
            reg = <0x0 0x33201c00 0x0 0x400>;
            gpio-controller;
            #gpio-cells = <2>;
            interrupt-parent = <&gic500>;
            interrupt-controller;
            #interrupt-cells = <2>;
            interrupts = <GIC_SPI 125 IRQ_TYPE_LEVEL_HIGH>;
            clocks = <&sysclk>;
            design-variant = <512>;
            ngpios = <128>;
            bus-frequency = <12000000>;
            apb-frequency = <100000000>;
            dout-init = <0x00000000 0x00000000
                         0x00000000 0x00000000>;
            status = "disabled";
        };
    };
```

## Documentation/devicetree/bindings/net/axiado,ax3005-mctp-irot.yaml
```yaml
# SPDX-License-Identifier: GPL-2.0 OR BSD-2-Clause
%YAML 1.2
---
$id: http://devicetree.org/schemas/net/axiado,ax3005-mctp-irot.yaml#
$schema: http://devicetree.org/meta-schemas/core.yaml#

title: Axiado AX3005 MCTP over Shared Memory + Mailbox Transport

maintainers:
  - Akhila Kavi <akavi@axiado.com>
  - Prasad Bolisetty <pbolisetty@axiado.com>

description: |
  MCTP transport between the AX3005 application processor and its
  root-of-trust (RoT) co-processor. MCTP packets are carried in two
  shared-memory windows, one per direction, and a pair of mailbox channels
  act as doorbells: "tx" (processor to co-processor) and "rx" (co-processor
  to processor).

  The co-processor allocates both windows from the carve-out referenced by
  memory-region and reports their addresses at runtime.

properties:
  compatible:
    const: axiado,ax3005-mctp-irot

  mboxes:
    items:
      - description: TX doorbell channel (Processor to Co-Processor)
      - description: RX doorbell channel (Co-Processor to Processor)

  mbox-names:
    items:
      - const: tx
      - const: rx

  memory-region:
    maxItems: 1
    description:
      No-map carve-out that the co-processor allocates both MCTP windows
      from. It must hold two non-overlapping windows of at least 68 bytes
      each, the DMTF DSP0236 minimum MCTP transmission unit.

required:
  - compatible
  - mboxes
  - mbox-names
  - memory-region

additionalProperties: false

examples:
  - |
    mctp-irot {
        compatible = "axiado,ax3005-mctp-irot";
        /* AX3005 mailbox channels 0-7 are TX, 8-15 are RX */
        mboxes = <&mailbox0 0>, <&mailbox0 8>;
        mbox-names = "tx", "rx";
        memory-region = <&irot_mctp_mem>;
    };
```

## Documentation/devicetree/bindings/net/axiado,ax3005-mctp-mailbox.yaml
```yaml
# SPDX-License-Identifier: GPL-2.0 OR BSD-2-Clause
%YAML 1.2
---
$id: http://devicetree.org/schemas/net/axiado,ax3005-mctp-mailbox.yaml#
$schema: http://devicetree.org/meta-schemas/core.yaml#

title: Axiado MCTP over Shared Memory + Mailbox Transport

maintainers:
  - Akhila Kavi <akavi@axiado.com>
  - Sammai Chakravarthy <schakravarthy@axiado.com>
  - Prasad Bolisetty <pbolisetty@axiado.com>

description:
  MCTP transport for the Axiado AX3005 SoC. MCTP packets are carried in two
  reserved shared-memory windows (one per direction) referenced by
  memory-region phandles. A pair of mailbox channels is used purely as
  doorbells and acknowledgements - a "tx" channel (Processor to Co-Processor) and an "rx"
  channel (Co-Processor to Processor). The MTU is derived from the TX shared-memory window
  size, which is required to be at least the DMTF DSP0236 section 8.3 minimum
  MCTP MTU of 68 bytes.

properties:
  compatible:
    const: axiado,ax3005-mctp-mailbox

  memory-region:
    items:
      - description: TX shared memory (Processor writes, Co-Processor reads)
      - description: RX shared memory (Co-Processor writes, Processor reads)

  mboxes:
    items:
      - description: TX doorbell channel (Processor to Co-Processor)
      - description: RX doorbell channel (Co-Processor to Processor)

  mbox-names:
    items:
      - const: tx
      - const: rx

required:
  - compatible
  - memory-region
  - mboxes
  - mbox-names

additionalProperties: false

examples:
  - |
    mctp {
        compatible = "axiado,ax3005-mctp-mailbox";
        memory-region = <&shm_ap_to_rot>, <&shm_rot_to_ap>;
        mboxes = <&mailbox0 0>, <&mailbox0 8>;
        mbox-names = "tx", "rx";
    };
```
