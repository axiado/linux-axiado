## Documentation/devicetree/bindings/soc/axiado/axiado,ax3000-espi-snoop.yaml
```yaml
# SPDX-License-Identifier: (GPL-2.0-only OR BSD-2-Clause)
# Copyright (c) 2025-2026 Axiado Corporation
%YAML 1.2
---
$id: http://devicetree.org/schemas/soc/axiado/axiado,ax3000-espi-snoop.yaml#
$schema: http://devicetree.org/meta-schemas/core.yaml#

title: Axiado eSPI Snoop Driver

maintainers:
  - Rajan Patel <rpatel@axiado.com>
  - Satya Jena <sjena@axiado.com>
  - Prasad Bolisetty <pbolisetty@axiado.com>

description: |
  The eSPI Snoop device captures Port80 POST codes transmitted by
  the host over the eSPI bus. The snoop block is exposed as a
  memory-mapped peripheral of the parent eSPI controller, and
  registers are accessed directly through the SoC address space.

properties:
  compatible:
    const: axiado,ax3000-espi-snoop

  reg:
    maxItems: 1
    description:
      MMIO base address and register range size of the snoop block,
      directly addressable in the SoC memory map.

  interrupts:
    maxItems: 1
    description:
      Virtual interrupt identifier supplied by the parent eSPI
      controller. This corresponds to the interrupt bit position used
      by the parent controller's interrupt controller and is not a
      hardware GIC interrupt number. The associated interrupt-parent
      (see common interrupts binding) is normally inherited from this
      node's parent eSPI controller in the device tree hierarchy.

  io-addr:
    $ref: /schemas/types.yaml#/definitions/uint32
    description:
      Host I/O port address monitored by the snoop device. This is
      typically the Port80 POST code address used by the host firmware.

  addr-size:
    $ref: /schemas/types.yaml#/definitions/uint32
    minimum: 1
    description:
      Optional property that value specifies how many consecutive bytes are
      valid starting from the base address defined in the reg property.
      If not provided, the driver defaults to 4 bytes (0x80–0x83),
      corresponding to a 32-bit PostCode register.

required:
  - compatible
  - reg
  - interrupts
  - io-addr

additionalProperties: false

examples:
  - |
    espi@330d0000 {
        compatible = "axiado,ax3000-espi";
        reg = <0x330d0000 0x1000>;
        interrupt-parent = <&gic500>;
        interrupts = <0 266 4>, <0 134 4>;
        interrupt-names = "espi-core-intr", "ext-atu-intr";
        interrupt-controller;
        #interrupt-cells = <1>;
        #address-cells = <1>;
        #size-cells = <1>;
        ranges = <0x0 0x330d0000 0x3000>;

        espi-snoop@330d10c0 {
            compatible = "axiado,ax3000-espi-snoop";
            reg = <0x330d10c0 0x10>;
            interrupts = <13>;
            io-addr = <0x80>;
            addr-size = <4>;
        };
    };
```

## Documentation/devicetree/bindings/soc/axiado/axiado,ax3000-espi.yaml
```yaml
# SPDX-License-Identifier: (GPL-2.0-only OR BSD-2-Clause)
# Copyright (c) 2025-2026 Axiado Corporation
%YAML 1.2
---

$id: http://devicetree.org/schemas/soc/axiado/axiado,ax3000-espi.yaml#
$schema: http://devicetree.org/meta-schemas/core.yaml#

title: Axiado eSPI Controller Driver

maintainers:
  - Satya Jena <sjena@axiado.com>
  - Rajan Patel <rpatel@axiado.com>
  - Prasad Bolisetty <pbolisetty@axiado.com>

description: |
  The Axiado eSPI controller provides connectivity between a host
  system and embedded peripheral devices. The controller handles eSPI
  protocol communication and provides interrupt management for child
  peripheral devices.

  The controller is a top-level SoC peripheral accessed directly via
  MMIO on a 64-bit address bus, and uses ranges to map child addresses
  into the SoC address space.

properties:
  compatible:
    const: axiado,ax3000-espi

  reg:
    minItems: 3
    maxItems: 6

  reg-names:
    items:
      - const: espi-core
      - const: espi-perif
      - const: espi-atu

  interrupts:
    items:
      - description: eSPI IP core interrupt
      - description: External ATU interrupt for peripherals

  interrupt-names:
    items:
      - const: espi-core-intr
      - const: ext-atu-intr

  interrupt-controller: true

  "#interrupt-cells":
    const: 1
    description: |
      Interrupt specifier for child devices. The single cell contains the
      virtual interrupt number corresponding to bits in the external ATU
      ISR register.

  "#address-cells":
    const: 1

  "#size-cells":
    const: 1

  ranges: true

  axiado,fifo-flush-timeout-ms:
    minimum: 1
    maximum: 1000
    default: 100
    description:
      Timeout in milliseconds for FIFO flush operations.

  axiado,poll-delay-min-us:
    minimum: 1
    maximum: 100
    default: 10
    description:
      Minimum polling interval in microseconds between register reads.

  axiado,poll-delay-max-us:
    minimum: 1
    maximum: 100
    default: 20
    description:
      Maximum polling interval in microseconds between register reads.

patternProperties:
  "^[a-z][a-z0-9-]*@[0-9a-f]+$":
    type: object
    description: Child eSPI peripheral devices.

required:
  - compatible
  - reg
  - reg-names
  - interrupts
  - interrupt-names
  - interrupt-controller
  - "#interrupt-cells"
  - "#address-cells"
  - "#size-cells"
  - ranges

unevaluatedProperties: false

examples:
  - |
    #include <dt-bindings/interrupt-controller/irq.h>

    espi@330d0000 {
        compatible = "axiado,ax3000-espi";
        reg = <0x0 0x330d0000 0x0 0x1000>,
              <0x0 0x330d1000 0x0 0x1000>,
              <0x0 0x330d2000 0x0 0x1000>;
        reg-names = "espi-core", "espi-perif", "espi-atu";

        interrupt-parent = <&gic500>;
        interrupts = <0 266 IRQ_TYPE_LEVEL_HIGH>,
                     <0 134 IRQ_TYPE_LEVEL_HIGH>;
        interrupt-names = "espi-core-intr", "ext-atu-intr";
        interrupt-controller;
        #interrupt-cells = <1>;
        #address-cells = <1>;
        #size-cells = <1>;

        ranges = <0x0 0x330d0000 0x3000>;
    };
```

## Documentation/devicetree/bindings/usb/axiado,ax3000-udc.yaml
```yaml
# SPDX-License-Identifier: (GPL-2.0-only OR BSD-2-Clause)
%YAML 1.2
---
$id: http://devicetree.org/schemas/usb/axiado,ax3000-udc.yaml#
$schema: http://devicetree.org/meta-schemas/core.yaml#

title: Axiado AX3000/AX3005 USB Device Controller

maintainers:
  - Petar Stepanovic <pstepanovic@axiado.com>
  - Naveen Kumar Rajgiri Bassappa <rbnaveenkumar@axiado.com>
  - Prasad Bolisetty <pbolisetty@axiado.com>

description:
  Axiado USB dual-role controller based on the Corigine USB 3.1 IP core.
  Supports USB 3.1 SuperSpeed and USB 2.0 High-Speed device operation
  with control, bulk, interrupt, and isochronous transfers.

allOf:
  - $ref: usb.yaml#

properties:
  compatible:
    oneOf:
      - const: axiado,ax3000-udc
      - items:
          - const: axiado,ax3005-udc
          - const: axiado,ax3000-udc

  reg:
    maxItems: 1

  interrupts:
    maxItems: 1

  clocks:
    maxItems: 1

  resets:
    maxItems: 1

  phys:
    maxItems: 1

required:
  - compatible
  - reg
  - interrupts

unevaluatedProperties: false

examples:
  - |
    #include <dt-bindings/interrupt-controller/arm-gic.h>
    #include <dt-bindings/interrupt-controller/irq.h>

    soc {
        #address-cells = <2>;
        #size-cells = <2>;

        usb@81200000 {
            compatible = "axiado,ax3000-udc";
            reg = <0x0 0x81200000 0x0 0x100000>;
            interrupt-parent = <&gic500>;
            interrupts = <GIC_SPI 21 IRQ_TYPE_LEVEL_HIGH>;
            resets = <&reset 0>;
            phys = <&usb_phy>;
        };
    };
```

## arch/arm64/configs/ax3005_defconfig
```kconfig
CONFIG_SYSVIPC=y
CONFIG_NO_HZ_IDLE=y
CONFIG_HIGH_RES_TIMERS=y
CONFIG_BPF_SYSCALL=y
CONFIG_PREEMPT=y
CONFIG_IKCONFIG=y
CONFIG_IKCONFIG_PROC=y
CONFIG_CGROUPS=y
CONFIG_MEMCG=y
CONFIG_BLK_CGROUP=y
CONFIG_CGROUP_PIDS=y
CONFIG_CGROUP_FREEZER=y
CONFIG_CPUSETS=y
CONFIG_CGROUP_DEVICE=y
CONFIG_CGROUP_CPUACCT=y
CONFIG_CGROUP_BPF=y
CONFIG_NAMESPACES=y
CONFIG_USER_NS=y
CONFIG_BLK_DEV_INITRD=y
CONFIG_CC_OPTIMIZE_FOR_SIZE=y
CONFIG_EXPERT=y
CONFIG_KEXEC=y
CONFIG_KEXEC_FILE=y
CONFIG_ARCH_AXIADO=y
CONFIG_ARCH_AX3005=y
CONFIG_ARM64_VA_BITS_48=y
CONFIG_NR_CPUS=4
# CONFIG_ARM64_TAGGED_ADDR_ABI is not set
CONFIG_COMPAT=y
# CONFIG_ARM64_RAS_EXTN is not set
# CONFIG_ARM64_CNP is not set
# CONFIG_ARM64_PTR_AUTH is not set
# CONFIG_ARM64_AMU_EXTN is not set
# CONFIG_ARM64_BTI is not set
# CONFIG_ARM64_E0PD is not set
# CONFIG_ARM64_EPAN is not set
# CONFIG_ARM64_SVE is not set
# CONFIG_EFI is not set
# CONFIG_SECCOMP is not set
# CONFIG_COMPAT_32BIT_TIME is not set
CONFIG_MODULES=y
CONFIG_MODULE_UNLOAD=y
# CONFIG_CORE_DUMP_DEFAULT_ELF_HEADERS is not set
# CONFIG_COMPAT_BRK is not set
CONFIG_TRANSPARENT_HUGEPAGE=y
CONFIG_NET=y
CONFIG_PACKET=y
CONFIG_UNIX=y
CONFIG_INET=y
CONFIG_MCTP=y
CONFIG_PCI=y
CONFIG_PCIE_AXIADO_END_POINT=y
CONFIG_DEVTMPFS=y
CONFIG_DEVTMPFS_MOUNT=y
CONFIG_FW_LOADER_USER_HELPER=y
# CONFIG_ARM_SMCCC_SOC_ID is not set
CONFIG_MTD=y
CONFIG_MTD_BLOCK=y
CONFIG_MTD_PHRAM=y
CONFIG_MTD_SPI_NOR=y
CONFIG_BLK_DEV_LOOP=y
CONFIG_EEPROM_AT24=y
CONFIG_SCSI=y
CONFIG_BLK_DEV_SD=y
CONFIG_NETDEVICES=y
CONFIG_NET_VENDOR_AXIADO=y
CONFIG_AXIADO_MCTP_MAILBOX=y
CONFIG_INPUT_EVDEV=y
# CONFIG_SERIO_SERPORT is not set
CONFIG_SERIAL_XILINX_PS_UART=y
CONFIG_SERIAL_XILINX_PS_UART_CONSOLE=y
CONFIG_SERIAL_DEV_BUS=y
CONFIG_IPMI_HANDLER=y
# CONFIG_HW_RANDOM is not set
CONFIG_I2C_CHARDEV=y
CONFIG_I2C_MUX=y
CONFIG_I2C_MUX_GPMUX=y
CONFIG_I2C_MUX_PCA9541=y
CONFIG_I2C_MUX_PCA954x=y
CONFIG_I2C_CADENCE=y
CONFIG_I2C_SLAVE=y
CONFIG_I3C=y
CONFIG_CDNS_I3C_MASTER=y
CONFIG_I3CDEV=y
CONFIG_SPI=y
CONFIG_SPI_DESIGNWARE=y
CONFIG_SPI_DW_MMIO=y
CONFIG_GPIO_CADENCE=y
CONFIG_GPIO_PCA953X=y
CONFIG_GPIO_PCA953X_IRQ=y
CONFIG_POWER_RESET_SYSCON=y
CONFIG_SYSCON_REBOOT_MODE=y
CONFIG_SENSORS_MAX31790=y
CONFIG_SENSORS_LM75=y
CONFIG_SENSORS_AXIADO_PWM_FAN=y
CONFIG_REGULATOR=y
CONFIG_REGULATOR_FIXED_VOLTAGE=y
# CONFIG_MEDIA_CEC_SUPPORT is not set
CONFIG_MEDIA_SUPPORT=y
CONFIG_V4L_PLATFORM_DRIVERS=y
CONFIG_V4L_MEM2MEM_DRIVERS=y
CONFIG_VIDEO_AXIADO=y
CONFIG_DRM=y
CONFIG_DRM_AXIADO=y
CONFIG_AXIADO_HDMI=y
CONFIG_AXIADO_LCDC=y
CONFIG_FB=y
CONFIG_FB_MODE_HELPERS=y
CONFIG_USB=y
CONFIG_USB_ANNOUNCE_NEW_DEVICES=y
CONFIG_USB_XHCI_HCD=y
CONFIG_USB_XHCI_PLATFORM=y
CONFIG_USB_STORAGE=y
CONFIG_USB_GADGET=y
CONFIG_USB_CRG_UDC=y
CONFIG_USB_CONFIGFS=y
CONFIG_USB_CONFIGFS_MASS_STORAGE=y
CONFIG_USB_CONFIGFS_F_HID_AXIADO=y
CONFIG_MMC=y
CONFIG_MMC_SDHCI=y
CONFIG_MMC_SDHCI_PLTFM=y
CONFIG_MMC_SDHCI_OF_ARASAN=y
CONFIG_RTC_CLASS=y
# CONFIG_RTC_NVMEM is not set
CONFIG_RTC_DRV_CADENCE=y
# CONFIG_VIRTIO_MENU is not set
# CONFIG_VHOST_MENU is not set
# CONFIG_SURFACE_PLATFORMS is not set
CONFIG_MAILBOX=y
CONFIG_AXIADO_MAILBOX=y
# CONFIG_IOMMU_SUPPORT is not set
CONFIG_REMOTEPROC=y
CONFIG_AXIADO_SGPIO=y
CONFIG_IIO=y
CONFIG_AXIADO_SARADC=y
CONFIG_PWM=y
CONFIG_PWM_AXIADO=y
CONFIG_RESET_CONTROLLER=y
CONFIG_PHY_AX3000_EMMC=y
CONFIG_EXT2_FS=y
CONFIG_EXT4_FS=y
# CONFIG_DNOTIFY is not set
CONFIG_OVERLAY_FS=y
CONFIG_OVERLAY_FS_XINO_AUTO=y
CONFIG_VFAT_FS=y
CONFIG_FAT_DEFAULT_UTF8=y
CONFIG_EXFAT_FS=y
CONFIG_TMPFS=y
CONFIG_TMPFS_POSIX_ACL=y
CONFIG_SQUASHFS=y
CONFIG_SQUASHFS_XZ=y
CONFIG_SQUASHFS_ZSTD=y
CONFIG_NLS_CODEPAGE_437=y
CONFIG_NLS_ISO8859_1=y
CONFIG_FORTIFY_SOURCE=y
CONFIG_HARDENED_USERCOPY=y
CONFIG_PRINTK_TIME=y
# CONFIG_DEBUG_MISC is not set
CONFIG_STRIP_ASM_SYMS=y
CONFIG_SCHED_STACK_END_CHECK=y
CONFIG_PANIC_ON_OOPS=y
CONFIG_PANIC_TIMEOUT=-1
CONFIG_SOFTLOCKUP_DETECTOR=y
# CONFIG_FTRACE is not set
# CONFIG_STRICT_DEVMEM is not set
# CONFIG_RUNTIME_TESTING_MENU is not set
```

## drivers/gpu/drm/axiado/Kconfig
```kconfig
config DRM_AXIADO
	tristate "DRM Support for Axiado AX3000 Display Subsystem"
	depends on DRM && OF
	select DRM_KMS_HELPER
	select DRM_GEM_DMA_HELPER
	select DRM_CLIENT_SELECTION
	help
	  Choose this option to enable support for the Axiado AX3000
	  Display Subsystem DRM driver. The display-subsystem node
	  represents a container that ties together the display
	  pipeline blocks using the standard device-tree ports/endpoint
	  graph bindings.

	  If you want to use the AX3000 SoC integrated HDMI or related
	  display controllers under the Direct Rendering Manager (DRM)
	  framework, say Y or M here.

	  If unsure, say N.

config AXIADO_HDMI
	bool "Axiado AX3000 HDMI transmitter"
	depends on DRM_AXIADO
	help
	  Choose this option to enable support for the Axiado AX3000
	  HDMI driver. If you want to use the AX3000 SoC integrated HDMI or related
	  display controllers under the Direct Rendering Manager (DRM)
	  framework, say Y or M here.

	  If unsure, say N.

config AXIADO_LCDC
	bool "DRM Support for DB9000 LCD Controller"
	depends on DRM_AXIADO
	help
	  Choose this option to enable support for the Axiado AX3000
	  DB9000 display controller. The DB9000 is a display bridge
	  block inside the AX3000 SoC that connects the display
	  subsystem to an HDMI transmitter.
	  This driver integrates with the DRM framework and
	  implements the standard device-tree graph bindings for
	  encoders and bridges. The node is typically a child of
	  the display-subsystem in the SoC device tree.

	  Say Y or M if you want to use HDMI or related display
	  output through the DB9000 controller on AX3000 platforms.

	  If unsure, say N.
```

## drivers/net/mctp/Kconfig
```kconfig
if MCTP

menu "MCTP Device Drivers"

config MCTP_SERIAL
	tristate "MCTP serial transport"
	depends on TTY
	select CRC_CCITT
	help
	  This driver provides an MCTP-over-serial interface, through a
	  serial line-discipline, as defined by DMTF specification "DSP0253 -
	  MCTP Serial Transport Binding". By attaching the ldisc to a serial
	  device, we get a new net device to transport MCTP packets.

	  This allows communication with external MCTP endpoints which use
	  serial as their transport. It can also be used as an easy way to
	  provide MCTP connectivity between virtual machines, by forwarding
	  data between simple virtual serial devices.

	  Say y here if you need to connect to MCTP endpoints over serial. To
	  compile as a module, use m; the module will be called mctp-serial.

config MCTP_SERIAL_TEST
        bool "MCTP serial tests" if !KUNIT_ALL_TESTS
        depends on MCTP_SERIAL=y && KUNIT=y
        default KUNIT_ALL_TESTS

config MCTP_TRANSPORT_I2C
	tristate "MCTP SMBus/I2C transport"
	# i2c-mux is optional, but we must build as a module if i2c-mux is a module
	depends on I2C_MUX || !I2C_MUX
	depends on I2C
	depends on I2C_SLAVE
	select MCTP_FLOWS
	help
	  Provides a driver to access MCTP devices over SMBus/I2C transport,
	  from DMTF specification DSP0237. A MCTP protocol network device is
	  created for each I2C bus that has been assigned a mctp-i2c device.

config MCTP_TRANSPORT_I3C
	tristate "MCTP I3C transport"
	depends on I3C
	help
	  Provides a driver to access MCTP devices over I3C transport,
	  from DMTF specification DSP0233.
	  A MCTP protocol network device is created for each I3C bus
	  having a "mctp-controller" devicetree property.

config MCTP_TRANSPORT_USB
	tristate "MCTP USB transport"
	depends on USB
	help
	  Provides a driver to access MCTP devices over USB transport,
	  defined by DMTF specification DSP0283.

	  MCTP-over-USB interfaces are peer-to-peer, so each interface
	  represents a physical connection to one remote MCTP endpoint.

config AXIADO_MCTP_MAILBOX
	tristate "Axiado MCTP over shared memory and mailbox transport"
	depends on MAILBOX
	help
	  MCTP transport for Axiado AX3005 SoC platforms. Packets are carried
	  in two reserved shared-memory windows, one per direction, with a
	  pair of mailbox channels used as doorbells and acknowledgements
	  between the application processor and the on-chip co-processor.

	  A new MCTP network device is created for each "axiado,ax3005-mctp-mailbox"
	  device node.

config MCTP_TRANSPORT_SPI
	tristate "MCTP Over SPI Transprt"
	help
	  This is in Kernel mode Mctp Over Spi Driver.

endmenu

endif
```
